&i2c_3 {
	qcom,clk-freq-out = <400000>;
	atmel_2954@4a {									/*touch ic I2C bus adddress*/
		compatible = "atmel,2954";						/*dtsi name*/
		status = "disable";									/*OK-used*/
		reg = <0x4a>;									/*touch ic I2C bus adddress 0x4a -> @4a*/
		interrupt-parent = <&msm_gpio>;
		interrupts = <65 0x2>;							/*interrupt pin number*/

		pinctrl-names = "pmx_ts_active","pmx_ts_suspend";       /*Touch GPIO pin name setting*/
		pinctrl-0 = <&ts_int_active &ts_reset_active>;          /*Touch GPIO pin active setting*/
		pinctrl-1 = <&ts_int_suspend &ts_reset_suspend>;        /*Touch GPIO pin suspend setting*/

		atmel,avdd-gpio = <&msm_gpio 97 0x00>;	//GPIO[097] TOUCH_AVDD_EN
		atmel,dvdd-gpio = <&msm_gpio 38 0x00>;	//GPIO[038] TOUCH_DVDD_EN
		atmel,vio-gpio = <&msm_gpio 128 0x00>;	//GPIO[112] TOUCH_1V8_LDO_EN(VIO)
		atmel,reset-gpio = <&msm_gpio 64 0x00>;
		atmel,irq-gpio = <&msm_gpio 65 0x00>;
		atmel,numtouch = <10>;							/*multi-touch count*/
		atmel,irqflags = <0x00000002>;					/*interrup flag type*/
		atmel,t15_num_keys = <0>;
		atmel,fw_name = "atmel/b5/t1_1006v26.fw";
		atmel,panel_check = <0>;
		atmel,extra_fw_name = "atmel/b5/t1_1006v26.fw";
		atmel,accuracy_filter_enable = <0>;
		atmel,knock_on_type = <1>;
		atmel,auto_fw_update = <0>;
		// atmel,t15_extra_key_state = <0 0>;
		atmel,global_access_pixel = <0>;
		atmel,use_mfts = <1>; // Enable for CoF type only
		atmel,lcd_x = <1080>;
		atmel,lcd_y = <1920>;
		atmel,butt_check_enable = <0>;
		atmel,ghost_detection_enable = <0>;
		atmel,ghost_detection_value = <10 10 100 25 250 10>;
	};
	atmel_t1664@4a {
		compatible = "atmel,t1664";
		status = "ok";
		reg = <0x4a>;
		interrupt-parent = <&msm_gpio>;
		interrupts = <65 0x2>;							/*interrupt pin number*/

		pinctrl-names = "pmx_ts_active","pmx_ts_suspend";       /*Touch GPIO pin name setting*/
		pinctrl-0 = <&ts_int_active &ts_reset_active>;          /*Touch GPIO pin active setting*/
		pinctrl-1 = <&ts_int_suspend &ts_reset_suspend>;        /*Touch GPIO pin suspend setting*/

		atmel,avdd-gpio = <&msm_gpio 97 0x00>;	//GPIO[097] TOUCH_AVDD_EN
		atmel,dvdd-gpio = <&msm_gpio 38 0x00>;	//GPIO[038] TOUCH_DVDD_EN

		/*atmel,vio-gpio = <&msm_gpio 128 0x00>;*/	//GPIO[112] TOUCH_1V8_LDO_EN(VIO), B5J Deleted
		vio-supply = <&pm8950_l15>; //1V8

		atmel,reset-gpio = <&msm_gpio 64 0x00>;
		atmel,irq-gpio = <&msm_gpio 65 0x00>;
		atmel,numtouch = <10>;							/*multi-touch count*/
		atmel,irqflags = <0x00000002>;
		atmel,t15_num_keys = <0>;
		atmel,fw_name = "atmel/b5_jp/B5j_v0.09.fw";
		atmel,knock_on_type = <1>;
		atmel,global_access_pixel = <0>;
		atmel,use_mfts = <1>; // Enable for CoF type only
		atmel,lcd_x = <1200>;
		atmel,lcd_y = <1920>;
		atmel,butt_check_enable = <0>;
		atmel,use_debug_reason = <1>;
		atmel,use_lpwg_test = <1>;
	};
	novatek_nt11206@1 {
		compatible = "lge,nt11206";
		status = "disable";
		reg = <0x01>;
		interrupt-parent = <&msm_gpio>;
		interrupts = <65 0x2001>; // ONESHOT IRQF_TRIGGER_RISING
		irqflags = <0x00002001>; // IRQF_TRIGGER_RISING

		pinctrl-names = "touch_pin_active","touch_pin_sleep";       /*Touch GPIO pin name setting*/
		pinctrl-0 = <&ts_int_active &ts_reset_active>;          /*Touch GPIO pin active setting*/
		pinctrl-1 = <&ts_int_suspend &ts_reset_suspend>;        /*Touch GPIO pin suspend setting*/

		reset-gpio = <&msm_gpio 64 0x0>;
		irq-gpio = <&msm_gpio 65 0x2001>;

		/*Power*/
		vdd-gpio = <&msm_gpio 97 0x00>;
		vio-gpio = <&msm_gpio 128 0x00>;

		/*Caps*/
		max_x = <1200>;
		max_y = <1920>;
		max_pressure = <0xff>;
		max_width = <15>;
		max_orientation = <1>;
		max_id = <10>;

		/*role*/
		hw_reset_delay = <0>;
		sw_reset_delay = <90>;
		use_lpwg = <1>;
		use_lpwg_test = <1>;

		/* firmware */
		use_upgrade = <1>;
		fw_image = "novatek/b3/B3_040.bin";
		panel_spec = "novatek/b3/NT11206_limit.txt";
		panel_spec_mfts = "novatek/b3/NT11206_limit_mfts.txt";
	};
};
