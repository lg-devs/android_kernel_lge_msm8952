/* Copyright (c) 2014, Code Aurora Forum. All rights reserved.
 *
 * This program is free software; you can redistribute it and/or modify
 * it under the terms of the GNU General Public License version 2 and
 * only version 2 as published by the Free Software Foundation.
 *
 * This program is distributed in the hope that it will be useful,
 * but WITHOUT ANY WARRANTY; without even the implied warranty of
 * MERCHANTABILITY or FITNESS FOR A PARTICULAR PURPOSE.  See the
 * GNU General Public License for more details.
 */

&mdss_mdp {
	dsi_tovis_vid: qcom,mdss_dsi_tovis_ili7807b_fhd_video {
		compatible = "qcom,mdss-dsi-panel";
		qcom,mdss-dsi-panel-name = "TOVIS FHD video mode dsi panel";
		qcom,mdss-dsi-panel-controller = <&mdss_dsi0>;
		qcom,mdss-dsi-panel-type = "dsi_video_mode";
		qcom,mdss-dsi-panel-destination = "display_1";
		qcom,mdss-dsi-panel-framerate = <60>;
		qcom,mdss-dsi-virtual-channel-id = <0>;
		qcom,mdss-dsi-stream = <0>;

		qcom,mdss-dsi-panel-width = <1080>;
		qcom,mdss-dsi-panel-height = <1920>;
		qcom,mdss-dsi-h-front-porch = <152>;
		qcom,mdss-dsi-h-back-porch = <12>;
		qcom,mdss-dsi-h-pulse-width = <4>;
		qcom,mdss-dsi-h-sync-skew = <0>;
		qcom,mdss-dsi-v-back-porch = <4>;
		qcom,mdss-dsi-v-front-porch = <4>;
		qcom,mdss-dsi-v-pulse-width = <4>;

		qcom,mdss-pan-physical-width-dimension = <71>;
		qcom,mdss-pan-physical-height-dimension = <126>;

		qcom,mdss-dsi-h-left-border = <0>;
		qcom,mdss-dsi-h-right-border = <0>;
		qcom,mdss-dsi-v-top-border = <0>;
		qcom,mdss-dsi-v-bottom-border = <0>;
		qcom,mdss-dsi-bpp = <24>;
		qcom,mdss-dsi-color-order = "rgb_swap_rgb";
		qcom,mdss-dsi-underflow-color = <0x00>;
		qcom,mdss-dsi-border-color = <0>;

		qcom,mdss-dsi-on-command = [
			/* Power set */
			39 01 00 00 00 00 04 FF 78 07 01
			15 01 00 00 00 00 02 42 11
			15 01 00 00 00 00 02 43 BF
			15 01 00 00 00 00 02 44 A1
			15 01 00 00 00 00 02 45 39
			15 01 00 00 00 00 02 46 21
			15 01 00 00 00 00 02 4A 1A
			15 01 00 00 00 00 02 4B 1A
			15 01 00 00 00 00 02 50 32
			15 01 00 00 00 00 02 51 32
			15 01 00 00 00 00 02 A2 01
			15 01 00 00 00 00 02 A3 14
			39 01 00 00 00 00 04 FF 78 07 01
			15 01 00 00 00 00 02 22 06
			15 01 00 00 00 00 02 64 10
			15 01 00 00 00 00 02 65 07
			15 01 00 00 00 00 02 66 08
			15 01 00 00 00 00 02 6C 45
			15 01 00 00 00 00 02 6D 11
			39 01 00 00 00 00 04 FF 78 07 06
			15 01 00 00 00 00 02 00 42
			15 01 00 00 00 00 02 01 05
			15 01 00 00 00 00 02 02 04
			15 01 00 00 00 00 02 03 05
			15 01 00 00 00 00 02 04 00
			15 01 00 00 00 00 02 05 00
			15 01 00 00 00 00 02 06 00
			15 01 00 00 00 00 02 07 00
			15 01 00 00 00 00 02 08 00
			15 01 00 00 00 00 02 09 07
			15 01 00 00 00 00 02 0A 71
			15 01 00 00 00 00 02 0B 00
			15 01 00 00 00 00 02 0C 04
			15 01 00 00 00 00 02 0D 04
			15 01 00 00 00 00 02 0E 05
			15 01 00 00 00 00 02 0F 05
			15 01 00 00 00 00 02 10 00
			15 01 00 00 00 00 02 11 00
			15 01 00 00 00 00 02 12 00
			15 01 00 00 00 00 02 13 00
			15 01 00 00 00 00 02 31 08
			15 01 00 00 00 00 02 32 10
			15 01 00 00 00 00 02 33 12
			15 01 00 00 00 00 02 34 14
			15 01 00 00 00 00 02 35 16
			15 01 00 00 00 00 02 36 07
			15 01 00 00 00 00 02 37 07
			15 01 00 00 00 00 02 38 26
			15 01 00 00 00 00 02 39 22
			15 01 00 00 00 00 02 3A 22
			15 01 00 00 00 00 02 3B 28
			15 01 00 00 00 00 02 3C 2B
			15 01 00 00 00 00 02 3D 29
			15 01 00 00 00 00 02 3E 2C
			15 01 00 00 00 00 02 3F 2A
			15 01 00 00 00 00 02 40 2D
			15 01 00 00 00 00 02 41 09
			15 01 00 00 00 00 02 42 11
			15 01 00 00 00 00 02 43 13
			15 01 00 00 00 00 02 44 15
			15 01 00 00 00 00 02 45 17
			15 01 00 00 00 00 02 46 07
			15 01 00 00 00 00 02 47 07
			15 01 00 00 00 00 02 48 26
			15 01 00 00 00 00 02 49 22
			15 01 00 00 00 00 02 4A 22
			15 01 00 00 00 00 02 4B 28
			15 01 00 00 00 00 02 4C 2B
			15 01 00 00 00 00 02 4D 29
			15 01 00 00 00 00 02 4E 2C
			15 01 00 00 00 00 02 4F 2A
			15 01 00 00 00 00 02 50 2D
			15 01 00 00 00 00 02 61 09
			15 01 00 00 00 00 02 62 17
			15 01 00 00 00 00 02 63 15
			15 01 00 00 00 00 02 64 13
			15 01 00 00 00 00 02 65 11
			15 01 00 00 00 00 02 66 07
			15 01 00 00 00 00 02 67 07
			15 01 00 00 00 00 02 68 26
			15 01 00 00 00 00 02 69 22
			15 01 00 00 00 00 02 6A 22
			15 01 00 00 00 00 02 6B 28
			15 01 00 00 00 00 02 6C 2B
			15 01 00 00 00 00 02 6D 29
			15 01 00 00 00 00 02 6E 2C
			15 01 00 00 00 00 02 6F 2A
			15 01 00 00 00 00 02 70 2D
			15 01 00 00 00 00 02 71 08
			15 01 00 00 00 00 02 72 16
			15 01 00 00 00 00 02 73 14
			15 01 00 00 00 00 02 74 12
			15 01 00 00 00 00 02 75 10
			15 01 00 00 00 00 02 76 07
			15 01 00 00 00 00 02 77 07
			15 01 00 00 00 00 02 78 26
			15 01 00 00 00 00 02 79 22
			15 01 00 00 00 00 02 7A 22
			15 01 00 00 00 00 02 7B 28
			15 01 00 00 00 00 02 7C 2B
			15 01 00 00 00 00 02 7D 29
			15 01 00 00 00 00 02 7E 2C
			15 01 00 00 00 00 02 7F 2A
			15 01 00 00 00 00 02 80 2D
			15 01 00 00 00 00 02 D0 01
			15 01 00 00 00 00 02 D9 40
			15 01 00 00 00 00 02 DA 0C
			15 01 00 00 00 00 02 A0 04
			15 01 00 00 00 00 02 A1 00
			15 01 00 00 00 00 02 A2 04
			15 01 00 00 00 00 02 A3 10
			15 01 00 00 00 00 02 A6 11
			15 01 00 00 00 00 02 A7 00
			15 01 00 00 00 00 02 B1 00
			15 01 00 00 00 00 02 B2 08
			15 01 00 00 00 00 02 B3 08
			15 01 00 00 00 00 02 B5 80
			15 01 00 00 00 00 02 B6 80
			39 01 00 00 00 00 04 FF 78 07 08
			15 01 00 00 00 00 02 09 0E
			/* Gamma - RED */
			39 01 00 00 00 00 04 FF 78 07 02
			15 01 00 00 00 00 02 00 00
			15 01 00 00 00 00 02 01 00
			15 01 00 00 00 00 02 3C 00
			15 01 00 00 00 00 02 3D 00
			15 01 00 00 00 00 02 02 00
			15 01 00 00 00 00 02 03 08
			15 01 00 00 00 00 02 3E 00
			15 01 00 00 00 00 02 3F 08
			15 01 00 00 00 00 02 04 00
			15 01 00 00 00 00 02 05 36
			15 01 00 00 00 00 02 40 00
			15 01 00 00 00 00 02 41 36
			15 01 00 00 00 00 02 06 00
			15 01 00 00 00 00 02 07 51
			15 01 00 00 00 00 02 42 00
			15 01 00 00 00 00 02 43 51
			15 01 00 00 00 00 02 08 00
			15 01 00 00 00 00 02 09 68
			15 01 00 00 00 00 02 44 00
			15 01 00 00 00 00 02 45 68
			15 01 00 00 00 00 02 0A 00
			15 01 00 00 00 00 02 0B 80
			15 01 00 00 00 00 02 46 00
			15 01 00 00 00 00 02 47 80
			15 01 00 00 00 00 02 0C 00
			15 01 00 00 00 00 02 0D 90
			15 01 00 00 00 00 02 48 00
			15 01 00 00 00 00 02 49 90
			15 01 00 00 00 00 02 0E 00
			15 01 00 00 00 00 02 0F 9C
			15 01 00 00 00 00 02 4A 00
			15 01 00 00 00 00 02 4B 9C
			15 01 00 00 00 00 02 10 00
			15 01 00 00 00 00 02 11 AB
			15 01 00 00 00 00 02 4C 00
			15 01 00 00 00 00 02 4D AB
			15 01 00 00 00 00 02 12 00
			15 01 00 00 00 00 02 13 C5
			15 01 00 00 00 00 02 4E 00
			15 01 00 00 00 00 02 4F C5
			15 01 00 00 00 00 02 14 00
			15 01 00 00 00 00 02 15 E8
			15 01 00 00 00 00 02 50 00
			15 01 00 00 00 00 02 51 E8
			15 01 00 00 00 00 02 16 01
			15 01 00 00 00 00 02 17 25
			15 01 00 00 00 00 02 52 01
			15 01 00 00 00 00 02 53 25
			15 01 00 00 00 00 02 18 01
			15 01 00 00 00 00 02 19 5D
			15 01 00 00 00 00 02 54 01
			15 01 00 00 00 00 02 55 5D
			15 01 00 00 00 00 02 1A 01
			15 01 00 00 00 00 02 1B B2
			15 01 00 00 00 00 02 56 01
			15 01 00 00 00 00 02 57 B2
			15 01 00 00 00 00 02 1C 01
			15 01 00 00 00 00 02 1D EF
			15 01 00 00 00 00 02 58 01
			15 01 00 00 00 00 02 59 EF
			15 01 00 00 00 00 02 1E 01
			15 01 00 00 00 00 02 1F F1
			15 01 00 00 00 00 02 5A 01
			15 01 00 00 00 00 02 5B F1
			15 01 00 00 00 00 02 20 02
			15 01 00 00 00 00 02 21 30
			15 01 00 00 00 00 02 5C 02
			15 01 00 00 00 00 02 5D 30
			15 01 00 00 00 00 02 22 02
			15 01 00 00 00 00 02 23 6D
			15 01 00 00 00 00 02 5E 02
			15 01 00 00 00 00 02 5F 6D
			15 01 00 00 00 00 02 24 02
			15 01 00 00 00 00 02 25 94
			15 01 00 00 00 00 02 60 02
			15 01 00 00 00 00 02 61 94
			15 01 00 00 00 00 02 26 02
			15 01 00 00 00 00 02 27 C3
			15 01 00 00 00 00 02 62 02
			15 01 00 00 00 00 02 63 C3
			15 01 00 00 00 00 02 28 02
			15 01 00 00 00 00 02 29 EF
			15 01 00 00 00 00 02 64 02
			15 01 00 00 00 00 02 65 EF
			15 01 00 00 00 00 02 2A 03
			15 01 00 00 00 00 02 2B 2D
			15 01 00 00 00 00 02 66 03
			15 01 00 00 00 00 02 67 2D
			15 01 00 00 00 00 02 2C 03
			15 01 00 00 00 00 02 2D 40
			15 01 00 00 00 00 02 68 03
			15 01 00 00 00 00 02 69 40
			15 01 00 00 00 00 02 2E 03
			15 01 00 00 00 00 02 2F 50
			15 01 00 00 00 00 02 6A 03
			15 01 00 00 00 00 02 6B 50
			15 01 00 00 00 00 02 30 03
			15 01 00 00 00 00 02 31 58
			15 01 00 00 00 00 02 6C 03
			15 01 00 00 00 00 02 6D 58
			15 01 00 00 00 00 02 32 03
			15 01 00 00 00 00 02 33 5D
			15 01 00 00 00 00 02 6E 03
			15 01 00 00 00 00 02 6F 5D
			15 01 00 00 00 00 02 34 03
			15 01 00 00 00 00 02 35 63
			15 01 00 00 00 00 02 70 03
			15 01 00 00 00 00 02 71 63
			15 01 00 00 00 00 02 36 03
			15 01 00 00 00 00 02 37 78
			15 01 00 00 00 00 02 72 03
			15 01 00 00 00 00 02 73 78
			15 01 00 00 00 00 02 38 03
			15 01 00 00 00 00 02 39 D6
			15 01 00 00 00 00 02 74 03
			15 01 00 00 00 00 02 75 D6
			15 01 00 00 00 00 02 3A 03
			15 01 00 00 00 00 02 3B E6
			15 01 00 00 00 00 02 76 03
			15 01 00 00 00 00 02 77 E6
			15 01 00 00 00 00 02 78 01
			15 01 00 00 00 00 02 79 01
			/* Gamma - GREEN */
			39 01 00 00 00 00 04 FF 78 07 03
			15 01 00 00 00 00 02 00 00
			15 01 00 00 00 00 02 01 00
			15 01 00 00 00 00 02 3C 00
			15 01 00 00 00 00 02 3D 00
			15 01 00 00 00 00 02 02 00
			15 01 00 00 00 00 02 03 08
			15 01 00 00 00 00 02 3E 00
			15 01 00 00 00 00 02 3F 08
			15 01 00 00 00 00 02 04 00
			15 01 00 00 00 00 02 05 36
			15 01 00 00 00 00 02 40 00
			15 01 00 00 00 00 02 41 36
			15 01 00 00 00 00 02 06 00
			15 01 00 00 00 00 02 07 51
			15 01 00 00 00 00 02 42 00
			15 01 00 00 00 00 02 43 51
			15 01 00 00 00 00 02 08 00
			15 01 00 00 00 00 02 09 68
			15 01 00 00 00 00 02 44 00
			15 01 00 00 00 00 02 45 68
			15 01 00 00 00 00 02 0A 00
			15 01 00 00 00 00 02 0B 80
			15 01 00 00 00 00 02 46 00
			15 01 00 00 00 00 02 47 80
			15 01 00 00 00 00 02 0C 00
			15 01 00 00 00 00 02 0D 90
			15 01 00 00 00 00 02 48 00
			15 01 00 00 00 00 02 49 90
			15 01 00 00 00 00 02 0E 00
			15 01 00 00 00 00 02 0F 9C
			15 01 00 00 00 00 02 4A 00
			15 01 00 00 00 00 02 4B 9C
			15 01 00 00 00 00 02 10 00
			15 01 00 00 00 00 02 11 AB
			15 01 00 00 00 00 02 4C 00
			15 01 00 00 00 00 02 4D AB
			15 01 00 00 00 00 02 12 00
			15 01 00 00 00 00 02 13 C5
			15 01 00 00 00 00 02 4E 00
			15 01 00 00 00 00 02 4F C5
			15 01 00 00 00 00 02 14 00
			15 01 00 00 00 00 02 15 E8
			15 01 00 00 00 00 02 50 00
			15 01 00 00 00 00 02 51 E8
			15 01 00 00 00 00 02 16 01
			15 01 00 00 00 00 02 17 25
			15 01 00 00 00 00 02 52 01
			15 01 00 00 00 00 02 53 25
			15 01 00 00 00 00 02 18 01
			15 01 00 00 00 00 02 19 5D
			15 01 00 00 00 00 02 54 01
			15 01 00 00 00 00 02 55 5D
			15 01 00 00 00 00 02 1A 01
			15 01 00 00 00 00 02 1B B2
			15 01 00 00 00 00 02 56 01
			15 01 00 00 00 00 02 57 B2
			15 01 00 00 00 00 02 1C 01
			15 01 00 00 00 00 02 1D EF
			15 01 00 00 00 00 02 58 01
			15 01 00 00 00 00 02 59 EF
			15 01 00 00 00 00 02 1E 01
			15 01 00 00 00 00 02 1F F1
			15 01 00 00 00 00 02 5A 01
			15 01 00 00 00 00 02 5B F1
			15 01 00 00 00 00 02 20 02
			15 01 00 00 00 00 02 21 30
			15 01 00 00 00 00 02 5C 02
			15 01 00 00 00 00 02 5D 30
			15 01 00 00 00 00 02 22 02
			15 01 00 00 00 00 02 23 6D
			15 01 00 00 00 00 02 5E 02
			15 01 00 00 00 00 02 5F 6D
			15 01 00 00 00 00 02 24 02
			15 01 00 00 00 00 02 25 94
			15 01 00 00 00 00 02 60 02
			15 01 00 00 00 00 02 61 94
			15 01 00 00 00 00 02 26 02
			15 01 00 00 00 00 02 27 C3
			15 01 00 00 00 00 02 62 02
			15 01 00 00 00 00 02 63 C3
			15 01 00 00 00 00 02 28 02
			15 01 00 00 00 00 02 29 EF
			15 01 00 00 00 00 02 64 02
			15 01 00 00 00 00 02 65 EF
			15 01 00 00 00 00 02 2A 03
			15 01 00 00 00 00 02 2B 2D
			15 01 00 00 00 00 02 66 03
			15 01 00 00 00 00 02 67 2D
			15 01 00 00 00 00 02 2C 03
			15 01 00 00 00 00 02 2D 40
			15 01 00 00 00 00 02 68 03
			15 01 00 00 00 00 02 69 40
			15 01 00 00 00 00 02 2E 03
			15 01 00 00 00 00 02 2F 50
			15 01 00 00 00 00 02 6A 03
			15 01 00 00 00 00 02 6B 50
			15 01 00 00 00 00 02 30 03
			15 01 00 00 00 00 02 31 58
			15 01 00 00 00 00 02 6C 03
			15 01 00 00 00 00 02 6D 58
			15 01 00 00 00 00 02 32 03
			15 01 00 00 00 00 02 33 5D
			15 01 00 00 00 00 02 6E 03
			15 01 00 00 00 00 02 6F 5D
			15 01 00 00 00 00 02 34 03
			15 01 00 00 00 00 02 35 63
			15 01 00 00 00 00 02 70 03
			15 01 00 00 00 00 02 71 63
			15 01 00 00 00 00 02 36 03
			15 01 00 00 00 00 02 37 78
			15 01 00 00 00 00 02 72 03
			15 01 00 00 00 00 02 73 78
			15 01 00 00 00 00 02 38 03
			15 01 00 00 00 00 02 39 D6
			15 01 00 00 00 00 02 74 03
			15 01 00 00 00 00 02 75 D6
			15 01 00 00 00 00 02 3A 03
			15 01 00 00 00 00 02 3B E6
			15 01 00 00 00 00 02 76 03
			15 01 00 00 00 00 02 77 E6
			15 01 00 00 00 00 02 78 01
			15 01 00 00 00 00 02 79 01
			/* Gamma - BLUE */
			39 01 00 00 00 00 04 FF 78 07 04
			15 01 00 00 00 00 02 00 00
			15 01 00 00 00 00 02 01 00
			15 01 00 00 00 00 02 3C 00
			15 01 00 00 00 00 02 3D 00
			15 01 00 00 00 00 02 02 00
			15 01 00 00 00 00 02 03 08
			15 01 00 00 00 00 02 3E 00
			15 01 00 00 00 00 02 3F 08
			15 01 00 00 00 00 02 04 00
			15 01 00 00 00 00 02 05 36
			15 01 00 00 00 00 02 40 00
			15 01 00 00 00 00 02 41 36
			15 01 00 00 00 00 02 06 00
			15 01 00 00 00 00 02 07 51
			15 01 00 00 00 00 02 42 00
			15 01 00 00 00 00 02 43 51
			15 01 00 00 00 00 02 08 00
			15 01 00 00 00 00 02 09 68
			15 01 00 00 00 00 02 44 00
			15 01 00 00 00 00 02 45 68
			15 01 00 00 00 00 02 0A 00
			15 01 00 00 00 00 02 0B 80
			15 01 00 00 00 00 02 46 00
			15 01 00 00 00 00 02 47 80
			15 01 00 00 00 00 02 0C 00
			15 01 00 00 00 00 02 0D 90
			15 01 00 00 00 00 02 48 00
			15 01 00 00 00 00 02 49 90
			15 01 00 00 00 00 02 0E 00
			15 01 00 00 00 00 02 0F 9C
			15 01 00 00 00 00 02 4A 00
			15 01 00 00 00 00 02 4B 9C
			15 01 00 00 00 00 02 10 00
			15 01 00 00 00 00 02 11 AB
			15 01 00 00 00 00 02 4C 00
			15 01 00 00 00 00 02 4D AB
			15 01 00 00 00 00 02 12 00
			15 01 00 00 00 00 02 13 C5
			15 01 00 00 00 00 02 4E 00
			15 01 00 00 00 00 02 4F C5
			15 01 00 00 00 00 02 14 00
			15 01 00 00 00 00 02 15 E8
			15 01 00 00 00 00 02 50 00
			15 01 00 00 00 00 02 51 E8
			15 01 00 00 00 00 02 16 01
			15 01 00 00 00 00 02 17 25
			15 01 00 00 00 00 02 52 01
			15 01 00 00 00 00 02 53 25
			15 01 00 00 00 00 02 18 01
			15 01 00 00 00 00 02 19 5D
			15 01 00 00 00 00 02 54 01
			15 01 00 00 00 00 02 55 5D
			15 01 00 00 00 00 02 1A 01
			15 01 00 00 00 00 02 1B B2
			15 01 00 00 00 00 02 56 01
			15 01 00 00 00 00 02 57 B2
			15 01 00 00 00 00 02 1C 01
			15 01 00 00 00 00 02 1D EF
			15 01 00 00 00 00 02 58 01
			15 01 00 00 00 00 02 59 EF
			15 01 00 00 00 00 02 1E 01
			15 01 00 00 00 00 02 1F F1
			15 01 00 00 00 00 02 5A 01
			15 01 00 00 00 00 02 5B F1
			15 01 00 00 00 00 02 20 02
			15 01 00 00 00 00 02 21 30
			15 01 00 00 00 00 02 5C 02
			15 01 00 00 00 00 02 5D 30
			15 01 00 00 00 00 02 22 02
			15 01 00 00 00 00 02 23 6D
			15 01 00 00 00 00 02 5E 02
			15 01 00 00 00 00 02 5F 6D
			15 01 00 00 00 00 02 24 02
			15 01 00 00 00 00 02 25 94
			15 01 00 00 00 00 02 60 02
			15 01 00 00 00 00 02 61 94
			15 01 00 00 00 00 02 26 02
			15 01 00 00 00 00 02 27 C3
			15 01 00 00 00 00 02 62 02
			15 01 00 00 00 00 02 63 C3
			15 01 00 00 00 00 02 28 02
			15 01 00 00 00 00 02 29 EF
			15 01 00 00 00 00 02 64 02
			15 01 00 00 00 00 02 65 EF
			15 01 00 00 00 00 02 2A 03
			15 01 00 00 00 00 02 2B 2D
			15 01 00 00 00 00 02 66 03
			15 01 00 00 00 00 02 67 2D
			15 01 00 00 00 00 02 2C 03
			15 01 00 00 00 00 02 2D 40
			15 01 00 00 00 00 02 68 03
			15 01 00 00 00 00 02 69 40
			15 01 00 00 00 00 02 2E 03
			15 01 00 00 00 00 02 2F 50
			15 01 00 00 00 00 02 6A 03
			15 01 00 00 00 00 02 6B 50
			15 01 00 00 00 00 02 30 03
			15 01 00 00 00 00 02 31 58
			15 01 00 00 00 00 02 6C 03
			15 01 00 00 00 00 02 6D 58
			15 01 00 00 00 00 02 32 03
			15 01 00 00 00 00 02 33 5D
			15 01 00 00 00 00 02 6E 03
			15 01 00 00 00 00 02 6F 5D
			15 01 00 00 00 00 02 34 03
			15 01 00 00 00 00 02 35 63
			15 01 00 00 00 00 02 70 03
			15 01 00 00 00 00 02 71 63
			15 01 00 00 00 00 02 36 03
			15 01 00 00 00 00 02 37 78
			15 01 00 00 00 00 02 72 03
			15 01 00 00 00 00 02 73 78
			15 01 00 00 00 00 02 38 03
			15 01 00 00 00 00 02 39 D6
			15 01 00 00 00 00 02 74 03
			15 01 00 00 00 00 02 75 D6
			15 01 00 00 00 00 02 3A 03
			15 01 00 00 00 00 02 3B E6
			15 01 00 00 00 00 02 76 03
			15 01 00 00 00 00 02 77 E6
			15 01 00 00 00 00 02 78 01
			15 01 00 00 00 00 02 79 01
			/* Saturation Enhancement */
			39 01 00 00 00 00 04 FF 78 07 00
			15 01 00 00 00 00 02 55 80
			39 01 00 00 00 00 04 FF 78 07 05
			15 01 00 00 00 00 02 38 03
			/* Sleep Mode Out Sequence */
			39 01 00 00 01 00 04 FF 78 07 00
			/* Sleep out */
			05 01 00 00 78 00 01 11
			/* Display On */
			05 01 00 00 0A 00 01 29
			];
		qcom,mdss-dsi-off-command = [
			/* Sleep Mode in Sequence */
			39 01 00 00 01 00 04 FF 78 07 00
			/* Display off */
			05 01 00 00 0A 00 01 28
			/* Sleep in */
			05 01 00 00 78 00 01 10];
		qcom,mdss-dsi-on-command-state = "dsi_lp_mode";
		qcom,mdss-dsi-off-command-state = "dsi_lp_mode";
		qcom,mdss-dsi-h-sync-pulse = <0>;
		qcom,mdss-dsi-lane-map = "lane_map_0123";
		qcom,mdss-dsi-bllp-eof-power-mode;
		qcom,mdss-dsi-bllp-power-mode;
		qcom,mdss-dsi-lane-0-state;
		qcom,mdss-dsi-lane-1-state;
		qcom,mdss-dsi-lane-2-state;
		qcom,mdss-dsi-lane-3-state;
		qcom,mdss-dsi-panel-timings = [E7 36 24 00 66 6A
			2A 3A 2D 03 04 00];
		qcom,mdss-dsi-reset-sequence = <1 5>, <0 5>, <1 10>;
		qcom,mdss-dsi-t-clk-post = <0x3>;
		qcom,mdss-dsi-t-clk-pre = <0x2B>;
		qcom,mdss-dsi-dma-trigger = "trigger_sw";
		qcom,mdss-dsi-mdp-trigger = "none";
		qcom,cont-splash-enabled;
		qcom,mdss-dsi-pan-enable-dynamic-fps;
		qcom,mdss-dsi-pan-fps-update = "dfps_immediate_porch_mode_vfp";
		qcom,mdss-dsi-min-refresh-rate = <48>;

		lge,panel_power_sequence = <
			0    /*pre_msm_dss_enable_vreg*/
			0    /*post_msm_dss_enable_vreg*/
			0    /*pre_mdss_dsi_panel_reset*/
			0    /*post_mdss_dsi_panel_reset*/
			0    /*pre_mdss_dsi_panel_power_ctrl*/
			0    /*post_mdss_dsi_panel_power_ctrl*/
			0    /*post_mdss_dsi_blank*/
			0    /*post_mdss_dsi_panel_on*/
			0    /*post_mdss_dsi_panel_off*/
			0    /*lge_mdss_dsi_event_handler*/
			0    /*lge_msm_dss_enable_vreg*/
			0    /*lge_mdss_dsi_request_gpios*/
			0    /*lge_mdss_dsi_panel_reset*/
			0    /*lge_mdss_dsi_lane_config*/
			0    /*lge_mdss_dsi_ctrl_probe*/
			0    /*lge_dsi_panel_device_register*/
			0    /*lge_mdss_panel_parse_dt*/
			0    /*lge_panel_device_create*/
			0    /*lge_mdss_dsi_cmdlist_commit*/
			1    /*lge_mdss_dsi_panel_init*/
			0    /*lge_dump_mdss_reg*/
			0    /*lge_mdss_xlog_tout_handler_default*/
			0    /*lge_mdss_create_xlog_debug*/
			0    /*lge_mdss_dsi_panel_bl_ctrl*/
			>;
	};
};

