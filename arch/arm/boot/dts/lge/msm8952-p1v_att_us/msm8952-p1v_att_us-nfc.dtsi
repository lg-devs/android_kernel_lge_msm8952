/* Copyright (c) 2012, Code Aurora Forum. All rights reserved.
 *
 * This program is free software; you can redistribute it and/or modify
 * it under the terms of the GNU General Public License version 2 and
 * only version 2 as published by the Free Software Foundation.
 *
 * This program is distributed in the hope that it will be useful,
 * but WITHOUT ANY WARRANTY; without even the implied warranty of
 * MERCHANTABILITY or FITNESS FOR A PARTICULAR PURPOSE.  See the
 * GNU General Public License for more details.
 */

&soc {
      i2c@7af7000 { /* BLSP2 QUP 3 */
            pn547@28 {
            compatible = "nxp,pn547";
            reg = <0x28>;
            status = "ok";
            interrupt-parent = <&msm_gpio>;
            interrupts = <17 0x2>;
            nxp,gpio_irq = <&msm_gpio 17 0x00>;
            nxp,gpio_ven = <&msm_gpio 16 0x00>;
            nxp,gpio_mode = <&msm_gpio 133 0x00>;
            pinctrl-names = "nfc_active","nfc_suspend";
            pinctrl-0 = <&nfc_int_active &nfc_disable_active &nfc_mode_active>;
            pinctrl-1 = <&nfc_int_suspend &nfc_disable_suspend &nfc_mode_suspend>;
            qcom,clk-freq-out = <400000>;
            };
    };
};
