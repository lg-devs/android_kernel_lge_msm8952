qcom,LGE_BLT29_Tocad_7000mAh {
	/* #2580345_LGE_B5JKDDI_7000mAh_averaged_MasterSlave_Aug30th2016*/
	qcom,max-voltage-uv = <4350000>;
	qcom,nom-batt-capacity-mah = <7000>;
	qcom,batt-id-kohm = <10>;
	qcom,battery-beta = <4150>;
	qcom,battery-type = "LGE_BLT29_Tocad_7000mAh";
	qcom,chg-rslow-comp-c1 = <3073602>;
	qcom,chg-rslow-comp-c2 = <5501156>;
	qcom,chg-rs-to-rslow = <462096>;
	qcom,chg-rslow-comp-thr = <0xB8>;
	qcom,checksum = <0x616A>;
	qcom,gui-version = "PMI8950GUI - 2.0.0.16";
	qcom,fg-profile-data = [
		 D7 83 14 7C
		 1E 80 60 75
		 56 83 93 35
		 E1 80 2F 8C
		 35 82 75 99
		 59 BC B4 C8
		 5B 11 ED 83
		 59 7C 28 80
		 35 75 4E 83
		 AD 70 06 69
		 09 84 5D 82
		 27 99 4C BC
		 D5 C8 59 0E
		 E2 1B 09 5A
		 CE 6E C3 F5
		 17 44 15 44
		 07 41 00 00
		 43 46 99 28
		 97 38 00 00
		 00 00 00 00
		 00 00 00 00
		 35 68 35 68
		 65 6A 16 8A
		 7A 77 70 6B
		 2A 71 0B 89
		 0A 77 5D 6A
		 7D 60 6A A1
		 1E 3C 5A B2
		 56 A0 71 0C
		 28 00 FF 36
		 F0 11 30 03
		 00 00 00 0C
	];
};
