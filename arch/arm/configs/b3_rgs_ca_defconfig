## drivers/input/sensor/Kconfig
```kconfig
#
# Input misc drivers configuration
#
menuconfig INPUT_SENSOR
	bool "Sensor devices"
	help
	  Say Y here, and a list of Sensor input drivers will be displayed.
	  Everything that didn't fit into the other categories is here. This option
	  doesn't affect the kernel.

	  If unsure, say Y.

if INPUT_SENSOR

config SENSORS_K303C
	tristate "STM K303C 6axis axl+mag sensor support"
	depends on I2C
	help
	  If you say yes here you get support for STMicroelectronics's
	  Acceleration and eCompass Sesnsor K303C.

config SENSOR_RPR0521
	bool "RPR 0521 support"
	depends on I2C
	help
	  Support RPR-0521 as an input device.
	  Proximity and Light Sensor RPR0521.

endif
config SENSOR_ATMF04
       bool "ATMF04 support"
       depends on I2C
       help
         Support ATMF04 as an input device.

config LGE_USE_CAP_SENSOR
       bool "Capsensor device"
       help
         Support Capsensor for this model.

config SENSOR_ATMF04_2ND
       bool "Secondary ATMF04 support"
       depends on I2C
       help
         Support Secondary ATMF04 as an input device.
```

## drivers/input/touchscreen/lge_jp/Kconfig
```kconfig
#
# LGE touch core configuration
#

if INPUT_TOUCHSCREEN

menuconfig TOUCHSCREEN_ATMEL_T1664_JP 
	bool "ATMEL Touch T1664 for JP Model - Generic"
	depends on I2C 
	help
	  If your plaform is generic linux, say Y

endif
```

## drivers/mmc/Kconfig
```kconfig
#
# MMC subsystem configuration
#

menuconfig MMC
	tristate "MMC/SD/SDIO card support"
	depends on HAS_IOMEM
	help
	  This selects MultiMediaCard, Secure Digital and Secure
	  Digital I/O support.

	  If you want MMC/SD/SDIO support, you should say Y here and
	  also to your specific host controller driver.

config MMC_DEBUG
	bool "MMC debugging"
	depends on MMC != n
	help
	  This is an option for use by developers; most people should
	  say N here.  This enables MMC core and driver debugging.

config MMC_PERF_PROFILING
	bool "MMC performance profiling"
	depends on MMC != n
	default n
	help
	  If you say Y here, support will be added for collecting
	  performance numbers at the MMC Queue and Host layers.


config MMC_SKHYNIX_AWAKE_CMD5
	bool "Use CMD5 changing sleep/resume sequence"
	default n
	help
	  In order to reduce the Sleep/Resume time,
	  The Sequence was changed from (CMD7->CMD5->VCC off->VCC on->CMD0->CMD1->CMD2->CMD3)
	  to (CMD7->CMD5->VCC off->VCC on->CMD5->CMD7).
	  This time reduced to 30ms from 188ms.

config LGE_MMC_P1V_VDD_ALWAYS_ON
    bool "delete mmc_delay in the mmc_power_up()"
    help
        If you say Y here, delete mmc_delay in the mmc_power_up().
        This mmc_delay occurs the resume time delay issue(PONEV-3156).
	mmc_delay is not necessary because p1v of Vdd is always on.
	root cause is unknown. this is workaround code.

config LGE_MMC_BKOPS_ENABLE
	bool "enable BKOPS for eMMC"
	depends on MMC != n
	default n
	help
	  If you want to use BKOPS for eMMC, you have to set Y in kernel/arch/arm/configs/XXXX_defconfig file.

# LGE_CHANGE_S : D3-5T-FS@lge.com
config LGE_MMC_RESET_IF_HANG
	bool "MMC Reset if eMMC is hang. "
	default n
	help
	    Reset eMMC if eMMC is unaccessible. continously error on r/w cmd.
# LGE_CHANGE_E : D3-5T-FS@lge.com

config LGE_SHOW_SDCARD_DETECT_PIN_STATUS
    bool "Show SD Card Detect pin status"
    default n
    help
        Show SD Card Detect pin status at /sys/devices/soc/7864900.sdhci/mmc_host/mmc1/cd_status

if MMC

source "drivers/mmc/core/Kconfig"

source "drivers/mmc/card/Kconfig"

source "drivers/mmc/host/Kconfig"

endif # MMC
```

## drivers/soc/qcom/lge/Kconfig
```kconfig
config MACH_LGE
	bool "LGE Machine"
	help
	  Support for LGE machine.

menu "LGE Board Selection"

config MACH_MSM8952_B3
	bool "MSM8952 B3"
	depends on ARCH_MSM8916
	select MACH_LGE
	help
	  Support for the Qualcomm MSM8952 B3 device.

config MACH_MSM8952_B5
	bool "MSM8952 B5"
	depends on ARCH_MSM8916
	select MACH_LGE
	help
	  Support for the Qualcomm MSM8952 B5 device.

config MACH_MSM8952_B3_OPEN_KR
	bool "MSM8952 B3_OPEN_KR"
	depends on MACH_MSM8952_B3
	select MACH_LGE
	help
	  Support for the Qualcomm MSM8952 B3_OPEN_KR device.

config MACH_MSM8952_B3_ATT_US
	bool "MSM8952 B3_ATT_US"
	depends on MACH_MSM8952_B3
	select MACH_LGE
	help
	  Support for the Qualcomm MSM8952 B3_ATT_US device.

config MACH_MSM8952_B3_TMO_US
	bool "MSM8952 B3_TMO_US"
	depends on MACH_MSM8952_B3
	select MACH_LGE
	help
	  Support for the Qualcomm MSM8952 B3_TMO_US device.

config MACH_MSM8952_B3_RGS_CA
	bool "MSM8952 B3_RGS_CA"
	depends on MACH_MSM8952_B3
	select MACH_LGE
	help
	  Support for the Qualcomm MSM8952 B3_RGS_CA device.

config MACH_MSM8952_B3_BELL_CA
	bool "MSM8952 B3_BELL_CA"
	depends on MACH_MSM8952_B3
	select MACH_LGE
	help
	  Support for the Qualcomm MSM8952 B3_BELL_CA device.

config MACH_MSM8952_B3_JP_KDI
	bool "MSM8952 B3_JP_KDI"
	depends on MACH_MSM8952_B3
	select MACH_LGE
	help
	  Support for the Qualcomm MSM8952 B3_JP_KDI device.

config MACH_MSM8952_B5_ATT_US
	bool "MSM8952 B5_ATT_US"
	depends on MACH_MSM8952_B5
	select MACH_LGE
	help
	  Support for the Qualcomm MSM8952 B5_ATT_US device.

config MACH_MSM8952_B5_OPEN_KR
	bool "MSM8952 B5_OPEN_KR"
	depends on MACH_MSM8952_B5
	select MACH_LGE
	help
	  Support for the Qualcomm MSM8952 B5_OPEN_KR device.

config MACH_MSM8952_B5_ACG_US
	bool "MSM8952 B5_ACG_US"
	depends on MACH_MSM8952_B5
	select MACH_LGE
	help
	  Support for the Qualcomm MSM8952 B5_ACG_US device.

config MACH_MSM8952_B5_OPEN_US
	bool "MSM8952 B5_OPEN_US"
	depends on MACH_MSM8952_B5
	select MACH_LGE
	help
	  Support for the Qualcomm MSM8952 B5_OPEN_US device.

config MACH_MSM8952_B5_USC_US
	bool "MSM8952 B5_USC_US"
	depends on MACH_MSM8952_B5
	select MACH_LGE
	help
	  Support for the Qualcomm MSM8952 B5_USC_US device.

config MACH_MSM8952_B5_JP_KDI
	bool "MSM8952 B5_JP_KDI"
	depends on MACH_MSM8952_B5
	select MACH_LGE
	help
	  Support for the Qualcomm MSM8952 B5_JP_KDI device.

config MACH_MSM8952_P1V_ATT_US
	bool "MSM8952 P1V_ATT_US"
	depends on ARCH_MSM8916
	select MACH_LGE
	help
	  Support for the Qualcomm MSM8952 P1V_ATT_US device.

endmenu
```
