/* Copyright (c) 2014, Code Aurora Forum. All rights reserved.
 *
 * This program is free software; you can redistribute it and/or modify
 * it under the terms of the GNU General Public License version 2 and
 * only version 2 as published by the Free Software Foundation.
 *
 * This program is distributed in the hope that it will be useful,
 * but WITHOUT ANY WARRANTY; without even the implied warranty of
 * MERCHANTABILITY or FITNESS FOR A PARTICULAR PURPOSE.  See the
 * GNU General Public License for more details.
 */

&mdss_mdp {
	dsi_tovis_vid: qcom,mdss_dsi_tovis_nt51021_wuxga_video {
		compatible = "qcom,mdss-dsi-panel";
		qcom,mdss-dsi-panel-name = "TOVIS NT51021 wuxga video mode panel";
		qcom,mdss-dsi-panel-controller = <&mdss_dsi0>;
		qcom,mdss-dsi-panel-type = "dsi_video_mode";
		qcom,mdss-dsi-panel-destination = "display_1";
		qcom,mdss-dsi-panel-framerate = <60>;
		qcom,mdss-dsi-virtual-channel-id = <0>;
		qcom,mdss-dsi-stream = <0>;
		qcom,mdss-dsi-panel-width = <1200>;
		qcom,mdss-dsi-panel-height = <1920>;
		qcom,mdss-dsi-h-front-porch = <152>;
		qcom,mdss-dsi-h-back-porch = <52>;
		qcom,mdss-dsi-h-pulse-width = <4>;
		qcom,mdss-dsi-h-sync-skew = <0>;
		qcom,mdss-dsi-v-back-porch = <22>;
		qcom,mdss-dsi-v-front-porch = <28>;
		qcom,mdss-dsi-v-pulse-width = <1>;
		qcom,mdss-dsi-h-left-border = <0>;
		qcom,mdss-dsi-h-right-border = <0>;
		qcom,mdss-dsi-v-top-border = <0>;
		qcom,mdss-dsi-v-bottom-border = <0>;
		qcom,mdss-dsi-bpp = <24>;
		qcom,mdss-dsi-color-order = "rgb_swap_rgb";
		qcom,mdss-dsi-underflow-color = <0xff>;
		qcom,mdss-dsi-border-color = <0>;
		qcom,mdss-dsi-reset-sequence = <1 5>;
		qcom,cont-splash-enabled;
		//qcom,mdss-dsi-lane-hs = <1>;
		qcom,mdss-dsi-force-clock-lane-hs;
		qcom,mdss-dsi-init-delay-us = <20000>;
		qcom,mdss-dsi-on-command = [
		15 01 00 00 00 00 02 83 00
		15 01 00 00 00 00 02 84 00
//		15 01 00 00 00 00 02 97 C0  // Set terminal resistor to 75 ohm
		15 01 00 00 00 00 02 8C 8E  // Change HAVDD , V1/V14 , Gamma to register control
		15 01 00 00 00 00 02 CD 6C
		15 01 00 00 00 00 02 C8 FC

		15 01 00 00 00 00 02 FA 12  // Set HAVDD = 4.8V
		15 01 00 00 01 00 02 FD 1B  // Set V1 = 9.4V , V14 = 0.2V
		15 01 00 00 00 00 02 C4 12  // Set STV rising timing
		15 01 00 00 00 00 02 C5 77  // Set STV falling timing
		15 01 00 00 00 00 02 C6 12  // Set GCLK rising timing
		15 01 00 00 00 00 02 C7 77  // Set GCLK falling timing
		15 01 00 00 00 00 02 83 AA
		15 01 00 00 00 00 02 84 11
		15 01 00 00 00 00 02 A9 4B  // Set MIPI Rx ability to solve data loss
		15 01 00 00 00 00 02 A0 36  // Set Slave IC of MIPI D0/D1 lane delay 100ps
		15 01 00 00 00 00 02 A1 3F  // Set Slave IC of MIPI D2/D3 lane delay 150ps
		15 01 00 00 00 00 02 A2 2D  // Set Master IC of MIPI D0/D1 lane delay 50ps
		15 01 00 00 00 00 02 A3 36  // Set Master IC of MIPI D2/D3 lane delay 100ps
		//----R Gamma Register----
		15 01 00 00 00 00 02 83 AA
		15 01 00 00 00 00 02 84 11
		15 01 00 00 00 00 02 C0 0E
		15 01 00 00 00 00 02 C1 12
		15 01 00 00 00 00 02 C2 25
		15 01 00 00 00 00 02 C3 36
		15 01 00 00 00 00 02 C4 42
		15 01 00 00 00 00 02 C5 4B
		15 01 00 00 00 00 02 C6 57
		15 01 00 00 00 00 02 C7 60
		15 01 00 00 00 00 02 C8 69
		15 01 00 00 00 00 02 C9 DB
		15 01 00 00 00 00 02 CA DF
		15 01 00 00 00 00 02 CB F5
		15 01 00 00 00 00 02 CC FE
		15 01 00 00 00 00 02 CD FC
		15 01 00 00 00 00 02 CE F7
		15 01 00 00 00 00 02 CF F9
		15 01 00 00 00 00 02 D0 FB
		15 01 00 00 00 00 02 D1 0A
		15 01 00 00 00 00 02 D2 1F
		15 01 00 00 00 00 02 D3 40
		15 01 00 00 00 00 02 D4 4A
		15 01 00 00 00 00 02 D5 AE
		15 01 00 00 00 00 02 D6 B0
		15 01 00 00 00 00 02 D7 BB
		15 01 00 00 00 00 02 D8 C5
		15 01 00 00 00 00 02 D9 CE
		15 01 00 00 00 00 02 DA D8
		15 01 00 00 00 00 02 DB E7
		15 01 00 00 00 00 02 DC F0
		15 01 00 00 00 00 02 DD FF
		15 01 00 00 00 00 02 DE 00
		15 01 00 00 00 00 02 DF 2F
		15 01 00 00 00 00 02 E0 0E
		15 01 00 00 00 00 02 E1 12
		15 01 00 00 00 00 02 E2 25
		15 01 00 00 00 00 02 E3 36
		15 01 00 00 00 00 02 E4 42
		15 01 00 00 00 00 02 E5 4B
		15 01 00 00 00 00 02 E6 57
		15 01 00 00 00 00 02 E7 60
		15 01 00 00 00 00 02 E8 69
		15 01 00 00 00 00 02 E9 DB
		15 01 00 00 00 00 02 EA DF
		15 01 00 00 00 00 02 EB F5
		15 01 00 00 00 00 02 EC FE
		15 01 00 00 00 00 02 ED FC
		15 01 00 00 00 00 02 EE F7
		15 01 00 00 00 00 02 EF F9
		15 01 00 00 00 00 02 F0 FB
		15 01 00 00 00 00 02 F1 0A
		15 01 00 00 00 00 02 F2 1F
		15 01 00 00 00 00 02 F3 40
		15 01 00 00 00 00 02 F4 4A
		15 01 00 00 00 00 02 F5 AE
		15 01 00 00 00 00 02 F6 B0
		15 01 00 00 00 00 02 F7 BB
		15 01 00 00 00 00 02 F8 C5
		15 01 00 00 00 00 02 F9 CE
		15 01 00 00 00 00 02 FA D8
		15 01 00 00 00 00 02 FB E7
		15 01 00 00 00 00 02 FC F0
		15 01 00 00 00 00 02 FD FF
		15 01 00 00 00 00 02 FE 00
		15 01 00 00 00 00 02 FF 2F
		//----G Gamma Registe G-a
		15 01 00 00 00 00 02 83 BB
		15 01 00 00 00 00 02 84 22
		15 01 00 00 00 00 02 C0 0E
		15 01 00 00 00 00 02 C1 12
		15 01 00 00 00 00 02 C2 25
		15 01 00 00 00 00 02 C3 36
		15 01 00 00 00 00 02 C4 42
		15 01 00 00 00 00 02 C5 4B
		15 01 00 00 00 00 02 C6 57
		15 01 00 00 00 00 02 C7 60
		15 01 00 00 00 00 02 C8 69
		15 01 00 00 00 00 02 C9 DB
		15 01 00 00 00 00 02 CA DF
		15 01 00 00 00 00 02 CB F5
		15 01 00 00 00 00 02 CC FE
		15 01 00 00 00 00 02 CD FC
		15 01 00 00 00 00 02 CE F7
		15 01 00 00 00 00 02 CF F9
		15 01 00 00 00 00 02 D0 FB
		15 01 00 00 00 00 02 D1 0A
		15 01 00 00 00 00 02 D2 1F
		15 01 00 00 00 00 02 D3 40
		15 01 00 00 00 00 02 D4 4A
		15 01 00 00 00 00 02 D5 AE
		15 01 00 00 00 00 02 D6 B0
		15 01 00 00 00 00 02 D7 BB
		15 01 00 00 00 00 02 D8 C5
		15 01 00 00 00 00 02 D9 CE
		15 01 00 00 00 00 02 DA D8
		15 01 00 00 00 00 02 DB E7
		15 01 00 00 00 00 02 DC F0
		15 01 00 00 00 00 02 DD FF
		15 01 00 00 00 00 02 DE 00
		15 01 00 00 00 00 02 DF 2F
		15 01 00 00 00 00 02 E0 0E
		15 01 00 00 00 00 02 E1 12
		15 01 00 00 00 00 02 E2 25
		15 01 00 00 00 00 02 E3 36
		15 01 00 00 00 00 02 E4 42
		15 01 00 00 00 00 02 E5 4B
		15 01 00 00 00 00 02 E6 57
		15 01 00 00 00 00 02 E7 60
		15 01 00 00 00 00 02 E8 69
		15 01 00 00 00 00 02 E9 DB
		15 01 00 00 00 00 02 EA DF
		15 01 00 00 00 00 02 EB F5
		15 01 00 00 00 00 02 EC FE
		15 01 00 00 00 00 02 ED FC
		15 01 00 00 00 00 02 EE F7
		15 01 00 00 00 00 02 EF F9
		15 01 00 00 00 00 02 F0 FB
		15 01 00 00 00 00 02 F1 0A
		15 01 00 00 00 00 02 F2 1F
		15 01 00 00 00 00 02 F3 40
		15 01 00 00 00 00 02 F4 4A
		15 01 00 00 00 00 02 F5 AE
		15 01 00 00 00 00 02 F6 B0
		15 01 00 00 00 00 02 F7 BB
		15 01 00 00 00 00 02 F8 C5
		15 01 00 00 00 00 02 F9 CE
		15 01 00 00 00 00 02 FA D8
		15 01 00 00 00 00 02 FB E7
		15 01 00 00 00 00 02 FC F0
		15 01 00 00 00 00 02 FD FF
		15 01 00 00 00 00 02 FE 00
		15 01 00 00 00 00 02 FF 2F
		//----B Gamma Registe G-a
		15 01 00 00 00 00 02 83 CC
		15 01 00 00 00 00 02 84 33
		15 01 00 00 00 00 02 C0 0E
		15 01 00 00 00 00 02 C1 12
		15 01 00 00 00 00 02 C2 25
		15 01 00 00 00 00 02 C3 36
		15 01 00 00 00 00 02 C4 42
		15 01 00 00 00 00 02 C5 4B
		15 01 00 00 00 00 02 C6 57
		15 01 00 00 00 00 02 C7 60
		15 01 00 00 00 00 02 C8 69
		15 01 00 00 00 00 02 C9 DB
		15 01 00 00 00 00 02 CA DF
		15 01 00 00 00 00 02 CB F5
		15 01 00 00 00 00 02 CC FE
		15 01 00 00 00 00 02 CD FC
		15 01 00 00 00 00 02 CE F7
		15 01 00 00 00 00 02 CF F9
		15 01 00 00 00 00 02 D0 FB
		15 01 00 00 00 00 02 D1 0A
		15 01 00 00 00 00 02 D2 1F
		15 01 00 00 00 00 02 D3 40
		15 01 00 00 00 00 02 D4 4A
		15 01 00 00 00 00 02 D5 AE
		15 01 00 00 00 00 02 D6 B0
		15 01 00 00 00 00 02 D7 BB
		15 01 00 00 00 00 02 D8 C5
		15 01 00 00 00 00 02 D9 CE
		15 01 00 00 00 00 02 DA D8
		15 01 00 00 00 00 02 DB E7
		15 01 00 00 00 00 02 DC F0
		15 01 00 00 00 00 02 DD FF
		15 01 00 00 00 00 02 DE 00
		15 01 00 00 00 00 02 DF 2F
		15 01 00 00 00 00 02 E0 0E
		15 01 00 00 00 00 02 E1 12
		15 01 00 00 00 00 02 E2 25
		15 01 00 00 00 00 02 E3 36
		15 01 00 00 00 00 02 E4 42
		15 01 00 00 00 00 02 E5 4B
		15 01 00 00 00 00 02 E6 57
		15 01 00 00 00 00 02 E7 60
		15 01 00 00 00 00 02 E8 69
		15 01 00 00 00 00 02 E9 DB
		15 01 00 00 00 00 02 EA DF
		15 01 00 00 00 00 02 EB F5
		15 01 00 00 00 00 02 EC FE
		15 01 00 00 00 00 02 ED FC
		15 01 00 00 00 00 02 EE F7
		15 01 00 00 00 00 02 EF F9
		15 01 00 00 00 00 02 F0 FB
		15 01 00 00 00 00 02 F1 0A
		15 01 00 00 00 00 02 F2 1F
		15 01 00 00 00 00 02 F3 40
		15 01 00 00 00 00 02 F4 4A
		15 01 00 00 00 00 02 F5 AE
		15 01 00 00 00 00 02 F6 B0
		15 01 00 00 00 00 02 F7 BB
		15 01 00 00 00 00 02 F8 C5
		15 01 00 00 00 00 02 F9 CE
		15 01 00 00 00 00 02 FA D8
		15 01 00 00 00 00 02 FB E7
		15 01 00 00 00 00 02 FC F0
		15 01 00 00 00 00 02 FD FF
		15 01 00 00 00 00 02 FE 00
		15 01 00 00 00 00 02 FF 2F
		];

		qcom,mdss-dsi-off-command = [
		05 01 00 00 64 00 02 10 00
		];

		qcom,panel-charging-time-on-command = [
		15 01 00 00 00 00 02 83 00
		15 01 00 00 00 00 02 84 00
		15 01 00 00 00 00 02 C7 A6
		];

		qcom,panel-charging-time-off-command = [
		15 01 00 00 00 00 02 83 00
		15 01 00 00 00 00 02 84 00
		15 01 00 00 00 00 02 C7 77
		];

		qcom,panel-reader-mode-initial-step1-command = [
		15 01 00 00 00 00 02 83 00
		15 01 00 00 00 00 02 84 00
//		15 01 00 00 00 00 02 97 C0  // Set terminal resistor to 75 ohm
		15 01 00 00 00 00 02 8C 8E  // Change HAVDD , V1/V14 , Gamma to register control
		15 01 00 00 00 00 02 CD 6C
		15 01 00 00 00 00 02 C8 FC

		15 01 00 00 00 00 02 FA 12  // Set HAVDD = 4.8V
		15 01 00 00 01 00 02 FD 1B  // Set V1 = 9.4V , V14 = 0.2V
		15 01 00 00 00 00 02 C4 12  // Set STV rising timing
		15 01 00 00 00 00 02 C5 77  // Set STV falling timing
		15 01 00 00 00 00 02 C6 12  // Set GCLK rising timing
		15 01 00 00 00 00 02 C7 77  // Set GCLK falling timing
		15 01 00 00 00 00 02 83 AA
		15 01 00 00 00 00 02 84 11
		15 01 00 00 00 00 02 A9 4B  // Set MIPI Rx ability to solve data loss
		15 01 00 00 00 00 02 A0 36  // Set Slave IC of MIPI D0/D1 lane delay 100ps
		15 01 00 00 00 00 02 A1 3F  // Set Slave IC of MIPI D2/D3 lane delay 150ps
		15 01 00 00 00 00 02 A2 2D  // Set Master IC of MIPI D0/D1 lane delay 50ps
		15 01 00 00 00 00 02 A3 36  // Set Master IC of MIPI D2/D3 lane delay 100ps

/*
		15 01 00 00 00 00 02 83 00
		15 01 00 00 00 00 02 84 00
		15 01 00 00 00 00 02 8C 04
		
		15 01 00 00 00 00 02 83 AA
		15 01 00 00 00 00 02 84 11
		15 01 00 00 00 00 02 A9 4B
*/		
		//----R Gamma Register----
		15 01 00 00 00 00 02 83 AA
		15 01 00 00 00 00 02 84 11
		15 01 00 00 00 00 02 C0 00
		15 01 00 00 00 00 02 C1 00
		15 01 00 00 00 00 02 C2 12
		15 01 00 00 00 00 02 C3 17
		15 01 00 00 00 00 02 C4 20
		15 01 00 00 00 00 02 C5 2E
		15 01 00 00 00 00 02 C6 39
		15 01 00 00 00 00 02 C7 42
		15 01 00 00 00 00 02 C8 48
		15 01 00 00 00 00 02 C9 9F
		15 01 00 00 00 00 02 CA A4
		15 01 00 00 00 00 02 CB C0
		15 01 00 00 00 00 02 CC D0
		15 01 00 00 00 00 02 CD DB
		15 01 00 00 00 00 02 CE DF
		15 01 00 00 00 00 02 CF E1
		15 01 00 00 00 00 02 D0 E7
		15 01 00 00 00 00 02 D1 FD
		15 01 00 00 00 00 02 D2 12
		15 01 00 00 00 00 02 D3 35
		15 01 00 00 00 00 02 D4 3F
		15 01 00 00 00 00 02 D5 A9
		15 01 00 00 00 00 02 D6 B1
		15 01 00 00 00 00 02 D7 BA
		15 01 00 00 00 00 02 D8 C3
		15 01 00 00 00 00 02 D9 CD
		15 01 00 00 00 00 02 DA D9
		15 01 00 00 00 00 02 DB E6
		15 01 00 00 00 00 02 DC F6
		15 01 00 00 00 00 02 DD FF
		15 01 00 00 00 00 02 DE 00
		15 01 00 00 00 00 02 DF 0E
		15 01 00 00 00 00 02 E0 00
		15 01 00 00 00 00 02 E1 00
		15 01 00 00 00 00 02 E2 12
		15 01 00 00 00 00 02 E3 17
		15 01 00 00 00 00 02 E4 20
		15 01 00 00 00 00 02 E5 2E
		15 01 00 00 00 00 02 E6 39
		15 01 00 00 00 00 02 E7 42
		15 01 00 00 00 00 02 E8 48
		15 01 00 00 00 00 02 E9 9F
		15 01 00 00 00 00 02 EA A4
		15 01 00 00 00 00 02 EB C0
		15 01 00 00 00 00 02 EC D0
		15 01 00 00 00 00 02 ED DB
		15 01 00 00 00 00 02 EE DF
		15 01 00 00 00 00 02 EF E1
		15 01 00 00 00 00 02 F0 E7
		15 01 00 00 00 00 02 F1 FD
		15 01 00 00 00 00 02 F2 12
		15 01 00 00 00 00 02 F3 35
		15 01 00 00 00 00 02 F4 3F
		15 01 00 00 00 00 02 F5 A9
		15 01 00 00 00 00 02 F6 B1
		15 01 00 00 00 00 02 F7 BA
		15 01 00 00 00 00 02 F8 C3
		15 01 00 00 00 00 02 F9 CD
		15 01 00 00 00 00 02 FA D9
		15 01 00 00 00 00 02 FB E6
		15 01 00 00 00 00 02 FC F6
		15 01 00 00 00 00 02 FD FF
		15 01 00 00 00 00 02 FE 00
		15 01 00 00 00 00 02 FF 0E
		//----G Gamma Registe G-a
		15 01 00 00 00 00 02 83 BB
		15 01 00 00 00 00 02 84 22
		15 01 00 00 00 00 02 C0 00
		15 01 00 00 00 00 02 C1 08
		15 01 00 00 00 00 02 C2 0D
		15 01 00 00 00 00 02 C3 14
		15 01 00 00 00 00 02 C4 1B
		15 01 00 00 00 00 02 C5 23
		15 01 00 00 00 00 02 C6 2B
		15 01 00 00 00 00 02 C7 33
		15 01 00 00 00 00 02 C8 3B
		15 01 00 00 00 00 02 C9 8A
		15 01 00 00 00 00 02 CA 8F
		15 01 00 00 00 00 02 CB AC
		15 01 00 00 00 00 02 CC BD
		15 01 00 00 00 00 02 CD C5
		15 01 00 00 00 00 02 CE C3
		15 01 00 00 00 00 02 CF C5
		15 01 00 00 00 00 02 D0 C4
		15 01 00 00 00 00 02 D1 C8
		15 01 00 00 00 00 02 D2 D0
		15 01 00 00 00 00 02 D3 DD
		15 01 00 00 00 00 02 D4 D6
		15 01 00 00 00 00 02 D5 69
		15 01 00 00 00 00 02 D6 6D
		15 01 00 00 00 00 02 D7 71
		15 01 00 00 00 00 02 D8 75
		15 01 00 00 00 00 02 D9 79
		15 01 00 00 00 00 02 DA 7D
		15 01 00 00 00 00 02 DB 82
		15 01 00 00 00 00 02 DC 86
		15 01 00 00 00 00 02 DD 89
		15 01 00 00 00 00 02 DE 00
		15 01 00 00 00 00 02 DF 00
		15 01 00 00 00 00 02 E0 00
		15 01 00 00 00 00 02 E1 08
		15 01 00 00 00 00 02 E2 0D
		15 01 00 00 00 00 02 E3 14
		15 01 00 00 00 00 02 E4 1B
		15 01 00 00 00 00 02 E5 23
		15 01 00 00 00 00 02 E6 2B
		15 01 00 00 00 00 02 E7 33
		15 01 00 00 00 00 02 E8 3B
		15 01 00 00 00 00 02 E9 8A
		15 01 00 00 00 00 02 EA 8F
		15 01 00 00 00 00 02 EB AC
		15 01 00 00 00 00 02 EC BD
		15 01 00 00 00 00 02 ED C5
		15 01 00 00 00 00 02 EE C3
		15 01 00 00 00 00 02 EF C5
		15 01 00 00 00 00 02 F0 C4
		15 01 00 00 00 00 02 F1 C8
		15 01 00 00 00 00 02 F2 D0
		15 01 00 00 00 00 02 F3 DD
		15 01 00 00 00 00 02 F4 D6
		15 01 00 00 00 00 02 F5 69
		15 01 00 00 00 00 02 F6 6D
		15 01 00 00 00 00 02 F7 71
		15 01 00 00 00 00 02 F8 75
		15 01 00 00 00 00 02 F9 79
		15 01 00 00 00 00 02 FA 7D
		15 01 00 00 00 00 02 FB 82
		15 01 00 00 00 00 02 FC 86
		15 01 00 00 00 00 02 FD 89
		15 01 00 00 00 00 02 FE 00
		15 01 00 00 00 00 02 FF 00
		//----B Gamma Registe G-a
		15 01 00 00 00 00 02 83 CC
		15 01 00 00 00 00 02 84 33
		15 01 00 00 00 00 02 C0 00
		15 01 00 00 00 00 02 C1 00
		15 01 00 00 00 00 02 C2 0C
		15 01 00 00 00 00 02 C3 11
		15 01 00 00 00 00 02 C4 12
		15 01 00 00 00 00 02 C5 16
		15 01 00 00 00 00 02 C6 18
		15 01 00 00 00 00 02 C7 20
		15 01 00 00 00 00 02 C8 2B
		15 01 00 00 00 00 02 C9 78
		15 01 00 00 00 00 02 CA 82
		15 01 00 00 00 00 02 CB A2
		15 01 00 00 00 00 02 CC B3
		15 01 00 00 00 00 02 CD BB
		15 01 00 00 00 00 02 CE B8
		15 01 00 00 00 00 02 CF BA
		15 01 00 00 00 00 02 D0 B5
		15 01 00 00 00 00 02 D1 B4
		15 01 00 00 00 00 02 D2 B8
		15 01 00 00 00 00 02 D3 BF
		15 01 00 00 00 00 02 D4 B4
		15 01 00 00 00 00 02 D5 56
		15 01 00 00 00 00 02 D6 59
		15 01 00 00 00 00 02 D7 5C
		15 01 00 00 00 00 02 D8 5F
		15 01 00 00 00 00 02 D9 62
		15 01 00 00 00 00 02 DA 66
		15 01 00 00 00 00 02 DB 69
		15 01 00 00 00 00 02 DC 6C
		15 01 00 00 00 00 02 DD 6E
		15 01 00 00 00 00 02 DE 00
		15 01 00 00 00 00 02 DF 00
		15 01 00 00 00 00 02 E0 00
		15 01 00 00 00 00 02 E1 00
		15 01 00 00 00 00 02 E2 0C
		15 01 00 00 00 00 02 E3 11
		15 01 00 00 00 00 02 E4 12
		15 01 00 00 00 00 02 E5 16
		15 01 00 00 00 00 02 E6 18
		15 01 00 00 00 00 02 E7 20
		15 01 00 00 00 00 02 E8 2B
		15 01 00 00 00 00 02 E9 78
		15 01 00 00 00 00 02 EA 82
		15 01 00 00 00 00 02 EB A2
		15 01 00 00 00 00 02 EC B3
		15 01 00 00 00 00 02 ED BB
		15 01 00 00 00 00 02 EE B8
		15 01 00 00 00 00 02 EF BA
		15 01 00 00 00 00 02 F0 B5
		15 01 00 00 00 00 02 F1 B4
		15 01 00 00 00 00 02 F2 B8
		15 01 00 00 00 00 02 F3 BF
		15 01 00 00 00 00 02 F4 B4
		15 01 00 00 00 00 02 F5 56
		15 01 00 00 00 00 02 F6 59
		15 01 00 00 00 00 02 F7 5C
		15 01 00 00 00 00 02 F8 5F
		15 01 00 00 00 00 02 F9 62
		15 01 00 00 00 00 02 FA 66
		15 01 00 00 00 00 02 FB 69
		15 01 00 00 00 00 02 FC 6C
		15 01 00 00 00 00 02 FD 6E
		15 01 00 00 00 00 02 FE 00
		15 01 00 00 00 00 02 FF 00
		];

		qcom,panel-reader-mode-initial-step2-command = [
		15 01 00 00 00 00 02 83 00
		15 01 00 00 00 00 02 84 00
//		15 01 00 00 00 00 02 97 C0  // Set terminal resistor to 75 ohm
		15 01 00 00 00 00 02 8C 8E  // Change HAVDD , V1/V14 , Gamma to register control
		15 01 00 00 00 00 02 CD 6C
		15 01 00 00 00 00 02 C8 FC

		15 01 00 00 00 00 02 FA 12  // Set HAVDD = 4.8V
		15 01 00 00 01 00 02 FD 1B  // Set V1 = 9.4V , V14 = 0.2V
		15 01 00 00 00 00 02 C4 12  // Set STV rising timing
		15 01 00 00 00 00 02 C5 77  // Set STV falling timing
		15 01 00 00 00 00 02 C6 12  // Set GCLK rising timing
		15 01 00 00 00 00 02 C7 77  // Set GCLK falling timing
		15 01 00 00 00 00 02 83 AA
		15 01 00 00 00 00 02 84 11
		15 01 00 00 00 00 02 A9 4B  // Set MIPI Rx ability to solve data loss
		15 01 00 00 00 00 02 A0 36  // Set Slave IC of MIPI D0/D1 lane delay 100ps
		15 01 00 00 00 00 02 A1 3F  // Set Slave IC of MIPI D2/D3 lane delay 150ps
		15 01 00 00 00 00 02 A2 2D  // Set Master IC of MIPI D0/D1 lane delay 50ps
		15 01 00 00 00 00 02 A3 36  // Set Master IC of MIPI D2/D3 lane delay 100ps

/*
		15 01 00 00 00 00 02 83 00
		15 01 00 00 00 00 02 84 00
		15 01 00 00 00 00 02 8C 04

		15 01 00 00 00 00 02 83 AA
		15 01 00 00 00 00 02 84 11
		15 01 00 00 00 00 02 A9 4B
*/
		//----R Gamma Register----
		15 01 00 00 00 00 02 83 AA
		15 01 00 00 00 00 02 84 11
		15 01 00 00 00 00 02 C0 00
		15 01 00 00 00 00 02 C1 03
		15 01 00 00 00 00 02 C2 21
		15 01 00 00 00 00 02 C3 35
		15 01 00 00 00 00 02 C4 42
		15 01 00 00 00 00 02 C5 4A
		15 01 00 00 00 00 02 C6 52
		15 01 00 00 00 00 02 C7 5D
		15 01 00 00 00 00 02 C8 67
		15 01 00 00 00 00 02 C9 E7
		15 01 00 00 00 00 02 CA E6
		15 01 00 00 00 00 02 CB FA
		15 01 00 00 00 00 02 CC 03
		15 01 00 00 00 00 02 CD 04
		15 01 00 00 00 00 02 CE FF
		15 01 00 00 00 00 02 CF 02
		15 01 00 00 00 00 02 D0 04
		15 01 00 00 00 00 02 D1 16
		15 01 00 00 00 00 02 D2 2B
		15 01 00 00 00 00 02 D3 4C
		15 01 00 00 00 00 02 D4 55
		15 01 00 00 00 00 02 D5 B4
		15 01 00 00 00 00 02 D6 BB
		15 01 00 00 00 00 02 D7 C3
		15 01 00 00 00 00 02 D8 CB
		15 01 00 00 00 00 02 D9 D4
		15 01 00 00 00 00 02 DA DF
		15 01 00 00 00 00 02 DB EB
		15 01 00 00 00 00 02 DC F8
		15 01 00 00 00 00 02 DD FF
		15 01 00 00 00 00 02 DE D8
		15 01 00 00 00 00 02 DF 0F
		15 01 00 00 00 00 02 E0 00
		15 01 00 00 00 00 02 E1 03
		15 01 00 00 00 00 02 E2 21
		15 01 00 00 00 00 02 E3 35
		15 01 00 00 00 00 02 E4 42
		15 01 00 00 00 00 02 E5 4A
		15 01 00 00 00 00 02 E6 52
		15 01 00 00 00 00 02 E7 5D
		15 01 00 00 00 00 02 E8 67
		15 01 00 00 00 00 02 E9 E7
		15 01 00 00 00 00 02 EA E6
		15 01 00 00 00 00 02 EB FA
		15 01 00 00 00 00 02 EC 03
		15 01 00 00 00 00 02 ED 04
		15 01 00 00 00 00 02 EE FF
		15 01 00 00 00 00 02 EF 02
		15 01 00 00 00 00 02 F0 04
		15 01 00 00 00 00 02 F1 16
		15 01 00 00 00 00 02 F2 2B
		15 01 00 00 00 00 02 F3 4C
		15 01 00 00 00 00 02 F4 55
		15 01 00 00 00 00 02 F5 B4
		15 01 00 00 00 00 02 F6 BB
		15 01 00 00 00 00 02 F7 C3
		15 01 00 00 00 00 02 F8 CB
		15 01 00 00 00 00 02 F9 D4
		15 01 00 00 00 00 02 FA DF
		15 01 00 00 00 00 02 FB EB
		15 01 00 00 00 00 02 FC F8
		15 01 00 00 00 00 02 FD FF
		15 01 00 00 00 00 02 FE D8
		15 01 00 00 00 00 02 FF 0F
		//----G Gamma Registe G-a 
		15 01 00 00 00 00 02 83 BB
		15 01 00 00 00 00 02 84 22
		15 01 00 00 00 00 02 C0 00
		15 01 00 00 00 00 02 C1 17
		15 01 00 00 00 00 02 C2 23
		15 01 00 00 00 00 02 C3 31
		15 01 00 00 00 00 02 C4 3D
		15 01 00 00 00 00 02 C5 47
		15 01 00 00 00 00 02 C6 4D
		15 01 00 00 00 00 02 C7 55
		15 01 00 00 00 00 02 C8 5F
		15 01 00 00 00 00 02 C9 D5
		15 01 00 00 00 00 02 CA D5
		15 01 00 00 00 00 02 CB E9
		15 01 00 00 00 00 02 CC F1
		15 01 00 00 00 00 02 CD EE
		15 01 00 00 00 00 02 CE E3
		15 01 00 00 00 00 02 CF E5
		15 01 00 00 00 00 02 D0 DB
		15 01 00 00 00 00 02 D1 D8
		15 01 00 00 00 00 02 D2 DC
		15 01 00 00 00 00 02 D3 E6
		15 01 00 00 00 00 02 D4 DD
		15 01 00 00 00 00 02 D5 6B
		15 01 00 00 00 00 02 D6 6E
		15 01 00 00 00 00 02 D7 72
		15 01 00 00 00 00 02 D8 75
		15 01 00 00 00 00 02 D9 79
		15 01 00 00 00 00 02 DA 7C
		15 01 00 00 00 00 02 DB 80
		15 01 00 00 00 00 02 DC 84
		15 01 00 00 00 00 02 DD 86
		15 01 00 00 00 00 02 DE 00
		15 01 00 00 00 00 02 DF 00
		15 01 00 00 00 00 02 E0 00
		15 01 00 00 00 00 02 E1 17
		15 01 00 00 00 00 02 E2 23
		15 01 00 00 00 00 02 E3 31
		15 01 00 00 00 00 02 E4 3D
		15 01 00 00 00 00 02 E5 47
		15 01 00 00 00 00 02 E6 4D
		15 01 00 00 00 00 02 E7 55
		15 01 00 00 00 00 02 E8 5F
		15 01 00 00 00 00 02 E9 D5
		15 01 00 00 00 00 02 EA D5
		15 01 00 00 00 00 02 EB E9
		15 01 00 00 00 00 02 EC F1
		15 01 00 00 00 00 02 ED EE
		15 01 00 00 00 00 02 EE E3
		15 01 00 00 00 00 02 EF E5
		15 01 00 00 00 00 02 F0 DB
		15 01 00 00 00 00 02 F1 D8
		15 01 00 00 00 00 02 F2 DC
		15 01 00 00 00 00 02 F3 E6
		15 01 00 00 00 00 02 F4 DD
		15 01 00 00 00 00 02 F5 6B
		15 01 00 00 00 00 02 F6 6E
		15 01 00 00 00 00 02 F7 72
		15 01 00 00 00 00 02 F8 75
		15 01 00 00 00 00 02 F9 79
		15 01 00 00 00 00 02 FA 7C
		15 01 00 00 00 00 02 FB 80
		15 01 00 00 00 00 02 FC 84
		15 01 00 00 00 00 02 FD 86
		15 01 00 00 00 00 02 FE 00
		15 01 00 00 00 00 02 FF 00
		//----B Gamma Registe G-a 
		15 01 00 00 00 00 02 83 CC
		15 01 00 00 00 00 02 84 33
		15 01 00 00 00 00 02 C0 00
		15 01 00 00 00 00 02 C1 00
		15 01 00 00 00 00 02 C2 23
		15 01 00 00 00 00 02 C3 34
		15 01 00 00 00 00 02 C4 42
		15 01 00 00 00 00 02 C5 48
		15 01 00 00 00 00 02 C6 49
		15 01 00 00 00 00 02 C7 4A
		15 01 00 00 00 00 02 C8 4B
		15 01 00 00 00 00 02 C9 A6
		15 01 00 00 00 00 02 CA BA
		15 01 00 00 00 00 02 CB CF
		15 01 00 00 00 00 02 CC DA
		15 01 00 00 00 00 02 CD D6
		15 01 00 00 00 00 02 CE C5
		15 01 00 00 00 00 02 CF C7
		15 01 00 00 00 00 02 D0 B4
		15 01 00 00 00 00 02 D1 A2
		15 01 00 00 00 00 02 D2 9B
		15 01 00 00 00 00 02 D3 97
		15 01 00 00 00 00 02 D4 86
		15 01 00 00 00 00 02 D5 3B
		15 01 00 00 00 00 02 D6 3D
		15 01 00 00 00 00 02 D7 3F
		15 01 00 00 00 00 02 D8 41
		15 01 00 00 00 00 02 D9 43
		15 01 00 00 00 00 02 DA 45
		15 01 00 00 00 00 02 DB 47
		15 01 00 00 00 00 02 DC 49
		15 01 00 00 00 00 02 DD 4A
		15 01 00 00 00 00 02 DE 00
		15 01 00 00 00 00 02 DF 00
		15 01 00 00 00 00 02 E0 00
		15 01 00 00 00 00 02 E1 00
		15 01 00 00 00 00 02 E2 23
		15 01 00 00 00 00 02 E3 34
		15 01 00 00 00 00 02 E4 42
		15 01 00 00 00 00 02 E5 48
		15 01 00 00 00 00 02 E6 49
		15 01 00 00 00 00 02 E7 4A
		15 01 00 00 00 00 02 E8 4B
		15 01 00 00 00 00 02 E9 A6
		15 01 00 00 00 00 02 EA BA
		15 01 00 00 00 00 02 EB CF
		15 01 00 00 00 00 02 EC DA
		15 01 00 00 00 00 02 ED D6
		15 01 00 00 00 00 02 EE C5
		15 01 00 00 00 00 02 EF C7
		15 01 00 00 00 00 02 F0 B4
		15 01 00 00 00 00 02 F1 A2
		15 01 00 00 00 00 02 F2 9B
		15 01 00 00 00 00 02 F3 97
		15 01 00 00 00 00 02 F4 86
		15 01 00 00 00 00 02 F5 3B
		15 01 00 00 00 00 02 F6 3D
		15 01 00 00 00 00 02 F7 3F
		15 01 00 00 00 00 02 F8 41
		15 01 00 00 00 00 02 F9 43
		15 01 00 00 00 00 02 FA 45
		15 01 00 00 00 00 02 FB 47
		15 01 00 00 00 00 02 FC 49
		15 01 00 00 00 00 02 FD 4A
		15 01 00 00 00 00 02 FE 00
		15 01 00 00 00 00 02 FF 00
		];

		qcom,panel-reader-mode-initial-step3-command = [
		15 01 00 00 00 00 02 83 00
		15 01 00 00 00 00 02 84 00
//		15 01 00 00 00 00 02 97 C0  // Set terminal resistor to 75 ohm
		15 01 00 00 00 00 02 8C 8E  // Change HAVDD , V1/V14 , Gamma to register control
		15 01 00 00 00 00 02 CD 6C
		15 01 00 00 00 00 02 C8 FC

		15 01 00 00 00 00 02 FA 12  // Set HAVDD = 4.8V
		15 01 00 00 01 00 02 FD 1B  // Set V1 = 9.4V , V14 = 0.2V
		15 01 00 00 00 00 02 C4 12  // Set STV rising timing
		15 01 00 00 00 00 02 C5 77  // Set STV falling timing
		15 01 00 00 00 00 02 C6 12  // Set GCLK rising timing
		15 01 00 00 00 00 02 C7 77  // Set GCLK falling timing
		15 01 00 00 00 00 02 83 AA
		15 01 00 00 00 00 02 84 11
		15 01 00 00 00 00 02 A9 4B  // Set MIPI Rx ability to solve data loss
		15 01 00 00 00 00 02 A0 36  // Set Slave IC of MIPI D0/D1 lane delay 100ps
		15 01 00 00 00 00 02 A1 3F  // Set Slave IC of MIPI D2/D3 lane delay 150ps
		15 01 00 00 00 00 02 A2 2D  // Set Master IC of MIPI D0/D1 lane delay 50ps
		15 01 00 00 00 00 02 A3 36  // Set Master IC of MIPI D2/D3 lane delay 100ps
/*
		15 01 00 00 00 00 02 83 00
		15 01 00 00 00 00 02 84 00
		15 01 00 00 00 00 02 8C 04

		15 01 00 00 00 00 02 83 AA
		15 01 00 00 00 00 02 84 11
		15 01 00 00 00 00 02 A9 4B
*/		
		//----R Gamma Register----
		15 01 00 00 00 00 02 83 AA
		15 01 00 00 00 00 02 84 11
		15 01 00 00 00 00 02 C0 00
		15 01 00 00 00 00 02 C1 00
		15 01 00 00 00 00 02 C2 12
		15 01 00 00 00 00 02 C3 17
		15 01 00 00 00 00 02 C4 1E
		15 01 00 00 00 00 02 C5 26
		15 01 00 00 00 00 02 C6 2F
		15 01 00 00 00 00 02 C7 38
		15 01 00 00 00 00 02 C8 41
		15 01 00 00 00 00 02 C9 98
		15 01 00 00 00 00 02 CA A1
		15 01 00 00 00 00 02 CB C0
		15 01 00 00 00 00 02 CC D0
		15 01 00 00 00 00 02 CD DB
		15 01 00 00 00 00 02 CE DF
		15 01 00 00 00 00 02 CF E1
		15 01 00 00 00 00 02 D0 E7
		15 01 00 00 00 00 02 D1 FD
		15 01 00 00 00 00 02 D2 12
		15 01 00 00 00 00 02 D3 35
		15 01 00 00 00 00 02 D4 3F
		15 01 00 00 00 00 02 D5 A9
		15 01 00 00 00 00 02 D6 B1
		15 01 00 00 00 00 02 D7 BA
		15 01 00 00 00 00 02 D8 C3
		15 01 00 00 00 00 02 D9 CD
		15 01 00 00 00 00 02 DA D9
		15 01 00 00 00 00 02 DB E6
		15 01 00 00 00 00 02 DC F6
		15 01 00 00 00 00 02 DD FF
		15 01 00 00 00 00 02 DE 00
		15 01 00 00 00 00 02 DF 0E
		15 01 00 00 00 00 02 E0 00
		15 01 00 00 00 00 02 E1 00
		15 01 00 00 00 00 02 E2 12
		15 01 00 00 00 00 02 E3 17
		15 01 00 00 00 00 02 E4 1E
		15 01 00 00 00 00 02 E5 26
		15 01 00 00 00 00 02 E6 2F
		15 01 00 00 00 00 02 E7 38
		15 01 00 00 00 00 02 E8 41
		15 01 00 00 00 00 02 E9 98
		15 01 00 00 00 00 02 EA A1
		15 01 00 00 00 00 02 EB C0
		15 01 00 00 00 00 02 EC D0
		15 01 00 00 00 00 02 ED DB
		15 01 00 00 00 00 02 EE DF
		15 01 00 00 00 00 02 EF E1
		15 01 00 00 00 00 02 F0 E7
		15 01 00 00 00 00 02 F1 FD
		15 01 00 00 00 00 02 F2 12
		15 01 00 00 00 00 02 F3 35
		15 01 00 00 00 00 02 F4 3F
		15 01 00 00 00 00 02 F5 A9
		15 01 00 00 00 00 02 F6 B1
		15 01 00 00 00 00 02 F7 BA
		15 01 00 00 00 00 02 F8 C3
		15 01 00 00 00 00 02 F9 CD
		15 01 00 00 00 00 02 FA D9
		15 01 00 00 00 00 02 FB E6
		15 01 00 00 00 00 02 FC F6
		15 01 00 00 00 00 02 FD FF
		15 01 00 00 00 00 02 FE 00
		15 01 00 00 00 00 02 FF 0E
		//----G Gamma Registe G-a
		15 01 00 00 00 00 02 83 BB
		15 01 00 00 00 00 02 84 22
		15 01 00 00 00 00 02 C0 00
		15 01 00 00 00 00 02 C1 07
		15 01 00 00 00 00 02 C2 0C
		15 01 00 00 00 00 02 C3 13
		15 01 00 00 00 00 02 C4 1A
		15 01 00 00 00 00 02 C5 22
		15 01 00 00 00 00 02 C6 29
		15 01 00 00 00 00 02 C7 31
		15 01 00 00 00 00 02 C8 39
		15 01 00 00 00 00 02 C9 85
		15 01 00 00 00 00 02 CA 8C
		15 01 00 00 00 00 02 CB A8
		15 01 00 00 00 00 02 CC B7
		15 01 00 00 00 00 02 CD BE
		15 01 00 00 00 00 02 CE BB
		15 01 00 00 00 00 02 CF BC
		15 01 00 00 00 00 02 D0 B7
		15 01 00 00 00 00 02 D1 B6
		15 01 00 00 00 00 02 D2 BA
		15 01 00 00 00 00 02 D3 C2
		15 01 00 00 00 00 02 D4 B8
		15 01 00 00 00 00 02 D5 58
		15 01 00 00 00 00 02 D6 5B
		15 01 00 00 00 00 02 D7 5E
		15 01 00 00 00 00 02 D8 62
		15 01 00 00 00 00 02 D9 65
		15 01 00 00 00 00 02 DA 69
		15 01 00 00 00 00 02 DB 6C
		15 01 00 00 00 00 02 DC 70
		15 01 00 00 00 00 02 DD 72
		15 01 00 00 00 00 02 DE 00
		15 01 00 00 00 00 02 DF 00
		15 01 00 00 00 00 02 E0 00
		15 01 00 00 00 00 02 E1 07
		15 01 00 00 00 00 02 E2 0C
		15 01 00 00 00 00 02 E3 13
		15 01 00 00 00 00 02 E4 1A
		15 01 00 00 00 00 02 E5 22
		15 01 00 00 00 00 02 E6 29
		15 01 00 00 00 00 02 E7 31
		15 01 00 00 00 00 02 E8 39
		15 01 00 00 00 00 02 E9 85
		15 01 00 00 00 00 02 EA 8C
		15 01 00 00 00 00 02 EB A8
		15 01 00 00 00 00 02 EC B7
		15 01 00 00 00 00 02 ED BE
		15 01 00 00 00 00 02 EE BB
		15 01 00 00 00 00 02 EF BC
		15 01 00 00 00 00 02 F0 B7
		15 01 00 00 00 00 02 F1 B6
		15 01 00 00 00 00 02 F2 BA
		15 01 00 00 00 00 02 F3 C2
		15 01 00 00 00 00 02 F4 B8
		15 01 00 00 00 00 02 F5 58
		15 01 00 00 00 00 02 F6 5B
		15 01 00 00 00 00 02 F7 5E
		15 01 00 00 00 00 02 F8 62
		15 01 00 00 00 00 02 F9 65
		15 01 00 00 00 00 02 FA 69
		15 01 00 00 00 00 02 FB 6C
		15 01 00 00 00 00 02 FC 70
		15 01 00 00 00 00 02 FD 72
		15 01 00 00 00 00 02 FE 00
		15 01 00 00 00 00 02 FF 00
		//----B Gamma Registe G-a
		15 01 00 00 00 00 02 83 CC
		15 01 00 00 00 00 02 84 33
		15 01 00 00 00 00 02 C0 00
		15 01 00 00 00 00 02 C1 00
		15 01 00 00 00 00 02 C2 0C
		15 01 00 00 00 00 02 C3 0F
		15 01 00 00 00 00 02 C4 14
		15 01 00 00 00 00 02 C5 1C
		15 01 00 00 00 00 02 C6 20
		15 01 00 00 00 00 02 C7 22
		15 01 00 00 00 00 02 C8 23
		15 01 00 00 00 00 02 C9 48
		15 01 00 00 00 00 02 CA 5F
		15 01 00 00 00 00 02 CB 86
		15 01 00 00 00 00 02 CC 98
		15 01 00 00 00 00 02 CD 9E
		15 01 00 00 00 00 02 CE 96
		15 01 00 00 00 00 02 CF 98
		15 01 00 00 00 00 02 D0 8A
		15 01 00 00 00 00 02 D1 7D
		15 01 00 00 00 00 02 D2 77
		15 01 00 00 00 00 02 D3 73
		15 01 00 00 00 00 02 D4 62
		15 01 00 00 00 00 02 D5 28
		15 01 00 00 00 00 02 D6 2A
		15 01 00 00 00 00 02 D7 2C
		15 01 00 00 00 00 02 D8 2E
		15 01 00 00 00 00 02 D9 30
		15 01 00 00 00 00 02 DA 32
		15 01 00 00 00 00 02 DB 35
		15 01 00 00 00 00 02 DC 37
		15 01 00 00 00 00 02 DD 38
		15 01 00 00 00 00 02 DE 00
		15 01 00 00 00 00 02 DF 00
		15 01 00 00 00 00 02 E0 00
		15 01 00 00 00 00 02 E1 00
		15 01 00 00 00 00 02 E2 0C
		15 01 00 00 00 00 02 E3 0F
		15 01 00 00 00 00 02 E4 14
		15 01 00 00 00 00 02 E5 1C
		15 01 00 00 00 00 02 E6 20
		15 01 00 00 00 00 02 E7 22
		15 01 00 00 00 00 02 E8 23
		15 01 00 00 00 00 02 E9 48
		15 01 00 00 00 00 02 EA 5F
		15 01 00 00 00 00 02 EB 86
		15 01 00 00 00 00 02 EC 98
		15 01 00 00 00 00 02 ED 9E
		15 01 00 00 00 00 02 EE 96
		15 01 00 00 00 00 02 EF 98
		15 01 00 00 00 00 02 F0 8A
		15 01 00 00 00 00 02 F1 7D
		15 01 00 00 00 00 02 F2 77
		15 01 00 00 00 00 02 F3 73
		15 01 00 00 00 00 02 F4 62
		15 01 00 00 00 00 02 F5 28
		15 01 00 00 00 00 02 F6 2A
		15 01 00 00 00 00 02 F7 2C
		15 01 00 00 00 00 02 F8 2E
		15 01 00 00 00 00 02 F9 30
		15 01 00 00 00 00 02 FA 32
		15 01 00 00 00 00 02 FB 35
		15 01 00 00 00 00 02 FC 37
		15 01 00 00 00 00 02 FD 38
		15 01 00 00 00 00 02 FE 00
		15 01 00 00 00 00 02 FF 00
		];

		qcom,panel-reader-mode-step1-command = [
		15 01 00 00 00 00 02 83 00
		15 01 00 00 00 00 02 84 00
//		15 01 00 00 00 00 02 97 C0  // Set terminal resistor to 75 ohm
		15 01 00 00 00 00 02 8C 8E  // Change HAVDD , V1/V14 , Gamma to register control
		15 01 00 00 00 00 02 CD 6C
		15 01 00 00 00 00 02 C8 FC

		15 01 00 00 00 00 02 FA 12  // Set HAVDD = 4.8V
		15 01 00 00 01 00 02 FD 1B  // Set V1 = 9.4V , V14 = 0.2V
		15 01 00 00 00 00 02 C4 12  // Set STV rising timing
		15 01 00 00 00 00 02 C5 77  // Set STV falling timing
		15 01 00 00 00 00 02 C6 12  // Set GCLK rising timing
		15 01 00 00 00 00 02 C7 77  // Set GCLK falling timing
		15 01 00 00 00 00 02 83 AA
		15 01 00 00 00 00 02 84 11
		15 01 00 00 00 00 02 A9 4B  // Set MIPI Rx ability to solve data loss
		15 01 00 00 00 00 02 A0 36  // Set Slave IC of MIPI D0/D1 lane delay 100ps
		15 01 00 00 00 00 02 A1 3F  // Set Slave IC of MIPI D2/D3 lane delay 150ps
		15 01 00 00 00 00 02 A2 2D  // Set Master IC of MIPI D0/D1 lane delay 50ps
		15 01 00 00 00 00 02 A3 36  // Set Master IC of MIPI D2/D3 lane delay 100ps

/*
		15 01 00 00 00 00 02 83 00
		15 01 00 00 00 00 02 84 00
		15 01 00 00 00 00 02 8C 04

		15 01 00 00 00 00 02 83 AA
		15 01 00 00 00 00 02 84 11
		15 01 00 00 00 00 02 A9 4B
*/		
		
		// 34
		15 00 00 00 00 00 02 83 AA
		15 00 00 00 00 00 02 84 11
		//----R Gamma Register----
		15 00 00 00 00 00 02 C0 00
		15 00 00 00 00 00 02 C1 00
		15 00 00 00 00 00 02 C2 12
		15 00 00 00 00 00 02 C3 17
		15 00 00 00 00 00 02 C4 20
		15 00 00 00 00 00 02 C5 2E
		15 00 00 00 00 00 02 C6 39
		15 00 00 00 00 00 02 C7 42
		15 00 00 00 00 00 02 C8 48
		15 00 00 00 00 00 02 C9 9F
		15 00 00 00 00 00 02 CA A4
		15 00 00 00 00 00 02 CB C0
		15 00 00 00 00 00 02 CC D0				
		15 00 00 00 00 00 02 CD DB
		15 00 00 00 00 00 02 CE DF
		15 00 00 00 00 00 02 CF E1
		15 00 00 00 00 00 02 D0 E7
		15 00 00 00 00 00 02 D1 FD
		15 00 00 00 00 00 02 D2 12
		15 00 00 00 00 00 02 D3 35
		15 00 00 00 00 00 02 D4 3F
		15 00 00 00 00 00 02 D5 A9
		15 00 00 00 00 00 02 D6 B1
		15 00 00 00 00 00 02 D7 BA
		15 00 00 00 00 00 02 D8 C3
		15 00 00 00 00 00 02 D9 CD
		15 00 00 00 00 00 02 DA D9
		15 00 00 00 00 00 02 DB E6
		15 00 00 00 00 00 02 DC F6
		15 00 00 00 00 00 02 DD FF
		15 00 00 00 00 00 02 DE 00
		15 01 00 00 00 00 02 DF 0E		
		//34
		15 00 00 00 00 00 02 E0 00		
		15 00 00 00 00 00 02 E1 00	
		15 00 00 00 00 00 02 E2 12
		15 00 00 00 00 00 02 E3 17
		15 00 00 00 00 00 02 E4 20
		15 00 00 00 00 00 02 E5 2E
		15 00 00 00 00 00 02 E6 39
		15 00 00 00 00 00 02 E7 42
		15 00 00 00 00 00 02 E8 48
		15 00 00 00 00 00 02 E9 9F
		15 00 00 00 00 00 02 EA A4
		15 00 00 00 00 00 02 EB C0
		15 00 00 00 00 00 02 EC D0
		15 00 00 00 00 00 02 ED DB
		15 00 00 00 00 00 02 EE DF
		15 00 00 00 00 00 02 EF E1					
		15 00 00 00 00 00 02 F0 E7
		15 00 00 00 00 00 02 F1 FD
		15 00 00 00 00 00 02 F2 12
		15 00 00 00 00 00 02 F3 35
		15 00 00 00 00 00 02 F4 3F		
		15 00 00 00 00 00 02 F5 A9		
		15 00 00 00 00 00 02 F6 B1
		15 00 00 00 00 00 02 F7 BA
		15 00 00 00 00 00 02 F8 C3
		15 00 00 00 00 00 02 F9 CD
		15 00 00 00 00 00 02 FA D9
		15 00 00 00 00 00 02 FB E6
		15 00 00 00 00 00 02 FC F6
		15 00 00 00 00 00 02 FD FF
		15 00 00 00 00 00 02 FE 00
		15 00 00 00 00 00 02 FF 0E		
		//----G Gamma Registe G			
		15 00 00 00 00 00 02 83 BB	
		15 01 00 00 00 00 02 84 22		
		//----G Gamma Registe G
	  //32
		15 00 00 00 00 00 02 C0 00
		15 00 00 00 00 00 02 C1 08
		15 00 00 00 00 00 02 C2 0D
		15 00 00 00 00 00 02 C3 14
		15 00 00 00 00 00 02 C4 1B
		15 00 00 00 00 00 02 C5 23
		15 00 00 00 00 00 02 C6 2B
		15 00 00 00 00 00 02 C7 33
		15 00 00 00 00 00 02 C8 3B
		15 00 00 00 00 00 02 C9 8A		
		15 00 00 00 00 00 02 CA 8F
		15 00 00 00 00 00 02 CB AC
		15 00 00 00 00 00 02 CC BD
		15 00 00 00 00 00 02 CD C5	
		15 00 00 00 00 00 02 CE C3
		15 00 00 00 00 00 02 CF C5
		15 00 00 00 00 00 02 D0 C4
		15 00 00 00 00 00 02 D1 C8
		15 00 00 00 00 00 02 D2 D0
		15 00 00 00 00 00 02 D3 DD
		15 00 00 00 00 00 02 D4 D6
		15 00 00 00 00 00 02 D5 69
		15 00 00 00 00 00 02 D6 6D
		15 00 00 00 00 00 02 D7 71
		15 00 00 00 00 00 02 D8 75
		15 00 00 00 00 00 02 D9 79
		15 00 00 00 00 00 02 DA 7D
		15 00 00 00 00 00 02 DB 82
		15 00 00 00 00 00 02 DC 86
		15 00 00 00 00 00 02 DD 89
		15 00 00 00 00 00 02 DE 00
		15 01 00 00 00 00 02 DF 00
		//34
		15 00 00 00 00 00 02 E0 00
		15 00 00 00 00 00 02 E1 08				
		15 00 00 00 00 00 02 E2 0D
		15 00 00 00 00 00 02 E3 14
		15 00 00 00 00 00 02 E4 1B
		15 00 00 00 00 00 02 E5 23
		15 00 00 00 00 00 02 E6 2B
		15 00 00 00 00 00 02 E7 33
		15 00 00 00 00 00 02 E8 3B
		15 00 00 00 00 00 02 E9 8A
		15 00 00 00 00 00 02 EA 8F
		15 00 00 00 00 00 02 EB AC				
		15 00 00 00 00 00 02 EC BD
		15 00 00 00 00 00 02 ED C5		
		15 00 00 00 00 00 02 EE C3
		15 00 00 00 00 00 02 EF C5
		15 00 00 00 00 00 02 F0 C4
		15 00 00 00 00 00 02 F1 C8
		15 00 00 00 00 00 02 F2 D0
		15 00 00 00 00 00 02 F3 DD
		15 00 00 00 00 00 02 F4 D6
		15 00 00 00 00 00 02 F5 69
		15 00 00 00 00 00 02 F6 6D
		15 00 00 00 00 00 02 F7 71
		15 00 00 00 00 00 02 F8 75
		15 00 00 00 00 00 02 F9 79
		15 00 00 00 00 00 02 FA 7D
		15 00 00 00 00 00 02 FB 82
		15 00 00 00 00 00 02 FC 86
		15 00 00 00 00 00 02 FD 89
		15 00 00 00 00 00 02 FE 00
		15 00 00 00 00 00 02 FF 00
	  //change page 3		
		15 00 00 00 00 00 02 83 CC			
		15 01 00 00 00 00 02 84 33		
	  //----B Gamma Registe G-a
	  //32
		15 00 00 00 00 00 02 C0 00
		15 00 00 00 00 00 02 C1 00
		15 00 00 00 00 00 02 C2 0C
		15 00 00 00 00 00 02 C3 11
		15 00 00 00 00 00 02 C4 12
		15 00 00 00 00 00 02 C5 16
		15 00 00 00 00 00 02 C6 18
		15 00 00 00 00 00 02 C7 20
		15 00 00 00 00 00 02 C8 2B
		15 00 00 00 00 00 02 C9 78
		15 00 00 00 00 00 02 CA 82
		15 00 00 00 00 00 02 CB A2
		15 00 00 00 00 00 02 CC B3
		15 00 00 00 00 00 02 CD BB					
		15 00 00 00 00 00 02 CE B8
		15 00 00 00 00 00 02 CF BA
		15 00 00 00 00 00 02 D0 B5
		15 00 00 00 00 00 02 D1 B4
		15 00 00 00 00 00 02 D2 B8
		15 00 00 00 00 00 02 D3 BF
		15 00 00 00 00 00 02 D4 B4
		15 00 00 00 00 00 02 D5 56
		15 00 00 00 00 00 02 D6 59				
		15 00 00 00 00 00 02 D7 5C
		15 00 00 00 00 00 02 D8 5F
		15 00 00 00 00 00 02 D9 62
		15 00 00 00 00 00 02 DA 66
		15 00 00 00 00 00 02 DB 69
		15 00 00 00 00 00 02 DC 6C
		15 00 00 00 00 00 02 DD 6E
		15 00 00 00 00 00 02 DE 00
		15 01 00 00 00 00 02 DF 00
		//32
		15 00 00 00 00 00 02 E0 00
		15 00 00 00 00 00 02 E1 00			
		15 00 00 00 00 00 02 E2 0C
		15 00 00 00 00 00 02 E3 11
		15 00 00 00 00 00 02 E4 12
		15 00 00 00 00 00 02 E5 16
		15 00 00 00 00 00 02 E6 18
		15 00 00 00 00 00 02 E7 20
		15 00 00 00 00 00 02 E8 2B
		15 00 00 00 00 00 02 E9 78
		15 00 00 00 00 00 02 EA 82				
		15 00 00 00 00 00 02 EB A2		
	  15 00 00 00 00 00 02 EC B3
		15 00 00 00 00 00 02 ED BB					
		15 00 00 00 00 00 02 EE B8
		15 00 00 00 00 00 02 EF BA
		15 00 00 00 00 00 02 F0 B5
		15 00 00 00 00 00 02 F1 B4
		15 00 00 00 00 00 02 F2 B8
		15 00 00 00 00 00 02 F3 BF
		15 00 00 00 00 00 02 F4 B4
		15 00 00 00 00 00 02 F5 56
		15 00 00 00 00 00 02 F6 59
		15 00 00 00 00 00 02 F7 5C
		15 00 00 00 00 00 02 F8 5F
		15 00 00 00 00 00 02 F9 62
		15 00 00 00 00 00 02 FA 66
		15 00 00 00 00 00 02 FB 69
		15 00 00 00 00 00 02 FC 6C
		15 00 00 00 00 00 02 FD 6E
		15 00 00 00 00 00 02 FE 00
		15 01 00 00 64 00 02 FF 00
		];

		qcom,panel-reader-mode-step2-command = [
		15 01 00 00 00 00 02 83 00
		15 01 00 00 00 00 02 84 00
//		15 01 00 00 00 00 02 97 C0  // Set terminal resistor to 75 ohm
		15 01 00 00 00 00 02 8C 8E  // Change HAVDD , V1/V14 , Gamma to register control
		15 01 00 00 00 00 02 CD 6C
		15 01 00 00 00 00 02 C8 FC

		15 01 00 00 00 00 02 FA 12  // Set HAVDD = 4.8V
		15 01 00 00 01 00 02 FD 1B  // Set V1 = 9.4V , V14 = 0.2V
		15 01 00 00 00 00 02 C4 12  // Set STV rising timing
		15 01 00 00 00 00 02 C5 77  // Set STV falling timing
		15 01 00 00 00 00 02 C6 12  // Set GCLK rising timing
		15 01 00 00 00 00 02 C7 77  // Set GCLK falling timing
		15 01 00 00 00 00 02 83 AA
		15 01 00 00 00 00 02 84 11
		15 01 00 00 00 00 02 A9 4B  // Set MIPI Rx ability to solve data loss
		15 01 00 00 00 00 02 A0 36  // Set Slave IC of MIPI D0/D1 lane delay 100ps
		15 01 00 00 00 00 02 A1 3F  // Set Slave IC of MIPI D2/D3 lane delay 150ps
		15 01 00 00 00 00 02 A2 2D  // Set Master IC of MIPI D0/D1 lane delay 50ps
		15 01 00 00 00 00 02 A3 36  // Set Master IC of MIPI D2/D3 lane delay 100ps

/*
		15 01 00 00 00 00 02 83 00
		15 01 00 00 00 00 02 84 00
		15 01 00 00 00 00 02 8C 04

		15 01 00 00 00 00 02 83 AA
		15 01 00 00 00 00 02 84 11
		15 01 00 00 00 00 02 A9 4B
*/
		//----B Gamma Register----
		15 00 00 00 00 00 02 83 AA
		15 00 00 00 00 00 02 84 11
		15 00 00 00 00 00 02 C0 00
		15 00 00 00 00 00 02 C1 03
		15 00 00 00 00 00 02 C2 21
		15 00 00 00 00 00 02 C3 35
		15 00 00 00 00 00 02 C4 42
		15 00 00 00 00 00 02 C5 4A
		15 00 00 00 00 00 02 C6 52
		15 00 00 00 00 00 02 C7 5D
		15 00 00 00 00 00 02 C8 67
		15 00 00 00 00 00 02 C9 E7
		15 00 00 00 00 00 02 CA E6
		15 00 00 00 00 00 02 CB FA
		15 00 00 00 00 00 02 CC 03
		15 00 00 00 00 00 02 CD 04
		15 00 00 00 00 00 02 CE FF
		15 00 00 00 00 00 02 CF 02
		15 00 00 00 00 00 02 D0 04
		15 00 00 00 00 00 02 D1 16
		15 00 00 00 00 00 02 D2 2B
		15 00 00 00 00 00 02 D3 4C
		15 00 00 00 00 00 02 D4 55
		15 00 00 00 00 00 02 D5 B4
		15 00 00 00 00 00 02 D6 BB
		15 00 00 00 00 00 02 D7 C3
		15 00 00 00 00 00 02 D8 CB
		15 00 00 00 00 00 02 D9 D4
		15 00 00 00 00 00 02 DA DF
		15 00 00 00 00 00 02 DB EB
		15 00 00 00 00 00 02 DC F8
		15 00 00 00 00 00 02 DD FF
		15 00 00 00 00 00 02 DE D8
		15 01 00 00 00 00 02 DF 0F
		15 00 00 00 00 00 02 E0 00
		15 00 00 00 00 00 02 E1 03
		15 00 00 00 00 00 02 E2 21
		15 00 00 00 00 00 02 E3 35
		15 00 00 00 00 00 02 E4 42
		15 00 00 00 00 00 02 E5 4A
		15 00 00 00 00 00 02 E6 52
		15 00 00 00 00 00 02 E7 5D
		15 00 00 00 00 00 02 E8 67
		15 00 00 00 00 00 02 E9 E7
		15 00 00 00 00 00 02 EA E6
		15 00 00 00 00 00 02 EB FA
		15 00 00 00 00 00 02 EC 03
		15 00 00 00 00 00 02 ED 04
		15 00 00 00 00 00 02 EE FF
		15 00 00 00 00 00 02 EF 02
		15 00 00 00 00 00 02 F0 04
		15 00 00 00 00 00 02 F1 16
		15 00 00 00 00 00 02 F2 2B
		15 00 00 00 00 00 02 F3 4C
		15 00 00 00 00 00 02 F4 55
		15 00 00 00 00 00 02 F5 B4
		15 00 00 00 00 00 02 F6 BB
		15 00 00 00 00 00 02 F7 C3
		15 00 00 00 00 00 02 F8 CB
		15 00 00 00 00 00 02 F9 D4
		15 00 00 00 00 00 02 FA DF
		15 00 00 00 00 00 02 FB EB
		15 00 00 00 00 00 02 FC F8
		15 00 00 00 00 00 02 FD FF
		15 00 00 00 00 00 02 FE D8
		15 00 00 00 00 00 02 FF 0F

		//----G Gamma Registe G-a
		15 00 00 00 00 00 02 83 BB
		15 01 00 00 00 00 02 84 22
		15 00 00 00 00 00 02 C0 00
		15 00 00 00 00 00 02 C1 17
		15 00 00 00 00 00 02 C2 23
		15 00 00 00 00 00 02 C3 31
		15 00 00 00 00 00 02 C4 3D
		15 00 00 00 00 00 02 C5 47
		15 00 00 00 00 00 02 C6 4D
		15 00 00 00 00 00 02 C7 55
		15 00 00 00 00 00 02 C8 5F
		15 00 00 00 00 00 02 C9 D5
		15 00 00 00 00 00 02 CA D5
		15 00 00 00 00 00 02 CB E9
		15 00 00 00 00 00 02 CC F1
		15 00 00 00 00 00 02 CD EE
		15 00 00 00 00 00 02 CE E3
		15 00 00 00 00 00 02 CF E5
		15 00 00 00 00 00 02 D0 DB
		15 00 00 00 00 00 02 D1 D8
		15 00 00 00 00 00 02 D2 DC
		15 00 00 00 00 00 02 D3 E6
		15 00 00 00 00 00 02 D4 DD
		15 00 00 00 00 00 02 D5 6B
		15 00 00 00 00 00 02 D6 6E
		15 00 00 00 00 00 02 D7 72
		15 00 00 00 00 00 02 D8 75
		15 00 00 00 00 00 02 D9 79
		15 00 00 00 00 00 02 DA 7C
		15 00 00 00 00 00 02 DB 80
		15 00 00 00 00 00 02 DC 84
		15 00 00 00 00 00 02 DD 86
		15 00 00 00 00 00 02 DE 00
		15 01 00 00 00 00 02 DF 00
		15 00 00 00 00 00 02 E0 00
		15 00 00 00 00 00 02 E1 17
		15 00 00 00 00 00 02 E2 23
		15 00 00 00 00 00 02 E3 31
		15 00 00 00 00 00 02 E4 3D
		15 00 00 00 00 00 02 E5 47
		15 00 00 00 00 00 02 E6 4D
		15 00 00 00 00 00 02 E7 55
		15 00 00 00 00 00 02 E8 5F
		15 00 00 00 00 00 02 E9 D5
		15 00 00 00 00 00 02 EA D5
		15 00 00 00 00 00 02 EB E9
		15 00 00 00 00 00 02 EC F1
		15 00 00 00 00 00 02 ED EE
		15 00 00 00 00 00 02 EE E3
		15 00 00 00 00 00 02 EF E5
		15 00 00 00 00 00 02 F0 DB
		15 00 00 00 00 00 02 F1 D8
		15 00 00 00 00 00 02 F2 DC
		15 00 00 00 00 00 02 F3 E6
		15 00 00 00 00 00 02 F4 DD
		15 00 00 00 00 00 02 F5 6B
		15 00 00 00 00 00 02 F6 6E
		15 00 00 00 00 00 02 F7 72
		15 00 00 00 00 00 02 F8 75
		15 00 00 00 00 00 02 F9 79
		15 00 00 00 00 00 02 FA 7C
		15 00 00 00 00 00 02 FB 80
		15 00 00 00 00 00 02 FC 84
		15 00 00 00 00 00 02 FD 86
		15 00 00 00 00 00 02 FE 00
		15 00 00 00 00 00 02 FF 00

		//----R Gamma Register
		15 00 00 00 00 00 02 83 CC
		15 01 00 00 00 00 02 84 33
		15 00 00 00 00 00 02 C0 00
		15 00 00 00 00 00 02 C1 00
		15 00 00 00 00 00 02 C2 23
		15 00 00 00 00 00 02 C3 34
		15 00 00 00 00 00 02 C4 42
		15 00 00 00 00 00 02 C5 48
		15 00 00 00 00 00 02 C6 49
		15 00 00 00 00 00 02 C7 4A
		15 00 00 00 00 00 02 C8 4B
		15 00 00 00 00 00 02 C9 A6
		15 00 00 00 00 00 02 CA BA
		15 00 00 00 00 00 02 CB CF
		15 00 00 00 00 00 02 CC DA
		15 00 00 00 00 00 02 CD D6
		15 00 00 00 00 00 02 CE C5
		15 00 00 00 00 00 02 CF C7
		15 00 00 00 00 00 02 D0 B4
		15 00 00 00 00 00 02 D1 A2
		15 00 00 00 00 00 02 D2 9B
		15 00 00 00 00 00 02 D3 97
		15 00 00 00 00 00 02 D4 86
		15 00 00 00 00 00 02 D5 3B
		15 00 00 00 00 00 02 D6 3D
		15 00 00 00 00 00 02 D7 3F
		15 00 00 00 00 00 02 D8 41
		15 00 00 00 00 00 02 D9 43
		15 00 00 00 00 00 02 DA 45
		15 00 00 00 00 00 02 DB 47
		15 00 00 00 00 00 02 DC 49
		15 00 00 00 00 00 02 DD 4A
		15 00 00 00 00 00 02 DE 00
		15 01 00 00 00 00 02 DF 00
		15 00 00 00 00 00 02 E0 00
		15 00 00 00 00 00 02 E1 00
		15 00 00 00 00 00 02 E2 23
		15 00 00 00 00 00 02 E3 34
		15 00 00 00 00 00 02 E4 42
		15 00 00 00 00 00 02 E5 48
		15 00 00 00 00 00 02 E6 49
		15 00 00 00 00 00 02 E7 4A
		15 00 00 00 00 00 02 E8 4B
		15 00 00 00 00 00 02 E9 A6
		15 00 00 00 00 00 02 EA BA
		15 00 00 00 00 00 02 EB CF
		15 00 00 00 00 00 02 EC DA
		15 00 00 00 00 00 02 ED D6
		15 00 00 00 00 00 02 EE C5
		15 00 00 00 00 00 02 EF C7
		15 00 00 00 00 00 02 F0 B4
		15 00 00 00 00 00 02 F1 A2
		15 00 00 00 00 00 02 F2 9B
		15 00 00 00 00 00 02 F3 97
		15 00 00 00 00 00 02 F4 86
		15 00 00 00 00 00 02 F5 3B
		15 00 00 00 00 00 02 F6 3D
		15 00 00 00 00 00 02 F7 3F
		15 00 00 00 00 00 02 F8 41
		15 00 00 00 00 00 02 F9 43
		15 00 00 00 00 00 02 FA 45
		15 00 00 00 00 00 02 FB 47
		15 00 00 00 00 00 02 FC 49
		15 00 00 00 00 00 02 FD 4A
		15 00 00 00 00 00 02 FE 00
		15 01 00 00 64 00 02 FF 00
		];


		// MONO as step2
		qcom,panel-reader-mode-mono-step2-command = [
		15 01 00 00 00 00 02 83 00
		15 01 00 00 00 00 02 84 00
//		15 01 00 00 00 00 02 97 C0  // Set terminal resistor to 75 ohm
		15 01 00 00 00 00 02 8C 8E  // Change HAVDD , V1/V14 , Gamma to register control
		15 01 00 00 00 00 02 CD 6C
		15 01 00 00 00 00 02 C8 FC

		15 01 00 00 00 00 02 FA 12  // Set HAVDD = 4.8V
		15 01 00 00 01 00 02 FD 1B  // Set V1 = 9.4V , V14 = 0.2V
		15 01 00 00 00 00 02 C4 12  // Set STV rising timing
		15 01 00 00 00 00 02 C5 77  // Set STV falling timing
		15 01 00 00 00 00 02 C6 12  // Set GCLK rising timing
		15 01 00 00 00 00 02 C7 77  // Set GCLK falling timing
		15 01 00 00 00 00 02 83 AA
		15 01 00 00 00 00 02 84 11
		15 01 00 00 00 00 02 A9 4B  // Set MIPI Rx ability to solve data loss
		15 01 00 00 00 00 02 A0 36  // Set Slave IC of MIPI D0/D1 lane delay 100ps
		15 01 00 00 00 00 02 A1 3F  // Set Slave IC of MIPI D2/D3 lane delay 150ps
		15 01 00 00 00 00 02 A2 2D  // Set Master IC of MIPI D0/D1 lane delay 50ps
		15 01 00 00 00 00 02 A3 36  // Set Master IC of MIPI D2/D3 lane delay 100ps
		
/*
		15 01 00 00 00 00 02 83 00
		15 01 00 00 00 00 02 84 00
		15 01 00 00 00 00 02 8C 04
		
		15 01 00 00 00 00 02 83 AA
		15 01 00 00 00 00 02 84 11
		15 01 00 00 00 00 02 A9 4B
*/		
		15 00 00 00 00 00 02 83 CC
		15 00 00 00 00 00 02 84 33
		15 00 00 00 00 00 02 91 C0	//Level 13
		15 00 00 00 00 00 02 90 11	//CE ON
		
		//----B Gamma Register----
		//34
		15 00 00 00 00 00 02 83 AA
		15 00 00 00 00 00 02 84 11
		15 00 00 00 00 00 02 C0 00
		15 00 00 00 00 00 02 C1 03
		15 00 00 00 00 00 02 C2 21
		15 00 00 00 00 00 02 C3 35
		15 00 00 00 00 00 02 C4 42
		15 00 00 00 00 00 02 C5 4A
		15 00 00 00 00 00 02 C6 52
		15 00 00 00 00 00 02 C7 5D
		15 00 00 00 00 00 02 C8 67
		15 00 00 00 00 00 02 C9 E7
		15 00 00 00 00 00 02 CA E6
		15 00 00 00 00 00 02 CB FA
		15 00 00 00 00 00 02 CC 03
		15 00 00 00 00 00 02 CD 04
		15 00 00 00 00 00 02 CE FF
		15 00 00 00 00 00 02 CF 02
		15 00 00 00 00 00 02 D0 04
		15 00 00 00 00 00 02 D1 16
		15 00 00 00 00 00 02 D2 2B
		15 00 00 00 00 00 02 D3 4C
		15 00 00 00 00 00 02 D4 55
		15 00 00 00 00 00 02 D5 B4
		15 00 00 00 00 00 02 D6 BB
		15 00 00 00 00 00 02 D7 C3
		15 00 00 00 00 00 02 D8 CB
		15 00 00 00 00 00 02 D9 D4
		15 00 00 00 00 00 02 DA DF
		15 00 00 00 00 00 02 DB EB
		15 00 00 00 00 00 02 DC F8
		15 00 00 00 00 00 02 DD FF
		15 00 00 00 00 00 02 DE D8
		15 01 00 00 00 00 02 DF 0F
		//34
		
		15 00 00 00 00 00 02 83 CC
		15 00 00 00 00 00 02 84 33
		15 00 00 00 00 00 02 91 D7	//Level 23

		15 00 00 00 00 00 02 83 AA
		15 00 00 00 00 00 02 84 11

		15 00 00 00 00 00 02 E0 00
		15 00 00 00 00 00 02 E1 03
		15 00 00 00 00 00 02 E2 21
		15 00 00 00 00 00 02 E3 35
		15 00 00 00 00 00 02 E4 42
		15 00 00 00 00 00 02 E5 4A
		15 00 00 00 00 00 02 E6 52
		15 00 00 00 00 00 02 E7 5D
		15 00 00 00 00 00 02 E8 67
		15 00 00 00 00 00 02 E9 E7
		15 00 00 00 00 00 02 EA E6
		15 00 00 00 00 00 02 EB FA
		15 00 00 00 00 00 02 EC 03
		15 00 00 00 00 00 02 ED 04
		15 00 00 00 00 00 02 EE FF
		15 00 00 00 00 00 02 EF 02
		15 00 00 00 00 00 02 F0 04
		15 00 00 00 00 00 02 F1 16
		15 00 00 00 00 00 02 F2 2B
		15 00 00 00 00 00 02 F3 4C
		15 00 00 00 00 00 02 F4 55
		15 00 00 00 00 00 02 F5 B4
		15 00 00 00 00 00 02 F6 BB
		15 00 00 00 00 00 02 F7 C3
		15 00 00 00 00 00 02 F8 CB
		15 00 00 00 00 00 02 F9 D4
		15 00 00 00 00 00 02 FA DF
		15 00 00 00 00 00 02 FB EB
		15 00 00 00 00 00 02 FC F8
		15 00 00 00 00 00 02 FD FF
		15 00 00 00 00 00 02 FE D8
		15 00 00 00 00 00 02 FF 0F

		15 00 00 00 00 00 02 83 CC
		15 00 00 00 00 00 02 84 33
		15 01 00 00 00 00 02 91 E1	//Level 33

		//----G Gamma Registe G-a
		15 00 00 00 00 00 02 83 BB
		15 00 00 00 00 00 02 84 22
		//32		

		15 00 00 00 00 00 02 C0 00
		15 00 00 00 00 00 02 C1 17
		15 00 00 00 00 00 02 C2 23
		15 00 00 00 00 00 02 C3 31
		15 00 00 00 00 00 02 C4 3D
		15 00 00 00 00 00 02 C5 47
		15 00 00 00 00 00 02 C6 4D
		15 00 00 00 00 00 02 C7 55
		15 00 00 00 00 00 02 C8 5F
		15 00 00 00 00 00 02 C9 D5
		15 00 00 00 00 00 02 CA D5
		15 00 00 00 00 00 02 CB E9
		15 00 00 00 00 00 02 CC F1
		15 00 00 00 00 00 02 CD EE
		15 00 00 00 00 00 02 CE E3
		15 00 00 00 00 00 02 CF E5
		15 00 00 00 00 00 02 D0 DB
		15 00 00 00 00 00 02 D1 D8
		15 00 00 00 00 00 02 D2 DC
		15 00 00 00 00 00 02 D3 E6
		15 00 00 00 00 00 02 D4 DD
		15 00 00 00 00 00 02 D5 6B
		15 00 00 00 00 00 02 D6 6E
		15 00 00 00 00 00 02 D7 72
		15 00 00 00 00 00 02 D8 75
		15 00 00 00 00 00 02 D9 79
		15 00 00 00 00 00 02 DA 7C
		15 00 00 00 00 00 02 DB 80
		15 00 00 00 00 00 02 DC 84
		15 00 00 00 00 00 02 DD 86
		15 00 00 00 00 00 02 DE 00
		15 00 00 00 00 00 02 DF 00
		//34

		15 00 00 00 00 00 02 83 CC
		15 00 00 00 00 00 02 84 33
		15 01 00 00 00 00 02 91 EB	//Level 43

		15 00 00 00 00 00 02 83 BB
		15 00 00 00 00 00 02 84 22
		
		15 00 00 00 00 00 02 E0 00
		15 00 00 00 00 00 02 E1 17
		15 00 00 00 00 00 02 E2 23
		15 00 00 00 00 00 02 E3 31
		15 00 00 00 00 00 02 E4 3D
		15 00 00 00 00 00 02 E5 47
		15 00 00 00 00 00 02 E6 4D
		15 00 00 00 00 00 02 E7 55
		15 00 00 00 00 00 02 E8 5F
		15 00 00 00 00 00 02 E9 D5
		15 00 00 00 00 00 02 EA D5
		15 00 00 00 00 00 02 EB E9
		15 00 00 00 00 00 02 EC F1
		15 00 00 00 00 00 02 ED EE
		15 00 00 00 00 00 02 EE E3
		15 00 00 00 00 00 02 EF E5
		15 00 00 00 00 00 02 F0 DB
		15 00 00 00 00 00 02 F1 D8
		15 00 00 00 00 00 02 F2 DC
		15 00 00 00 00 00 02 F3 E6
		15 00 00 00 00 00 02 F4 DD
		15 00 00 00 00 00 02 F5 6B
		15 00 00 00 00 00 02 F6 6E
		15 00 00 00 00 00 02 F7 72
		15 00 00 00 00 00 02 F8 75
		15 00 00 00 00 00 02 F9 79
		15 00 00 00 00 00 02 FA 7C
		15 00 00 00 00 00 02 FB 80
		15 00 00 00 00 00 02 FC 84
		15 00 00 00 00 00 02 FD 86
		15 00 00 00 00 00 02 FE 00
		15 00 00 00 00 00 02 FF 00
		//----R Gamma Registe G-a
		//15 00 00 00 00 00 02 83 CC
		//15 01 00 00 00 00 02 84 33
		//32

		15 00 00 00 00 00 02 83 CC
		15 00 00 00 00 00 02 84 33
		15 01 00 00 00 00 02 91 F5	//Level 53

		15 00 00 00 00 00 02 C0 00
		15 00 00 00 00 00 02 C1 00
		15 00 00 00 00 00 02 C2 23
		15 00 00 00 00 00 02 C3 34
		15 00 00 00 00 00 02 C4 42
		15 00 00 00 00 00 02 C5 48
		15 00 00 00 00 00 02 C6 49
		15 00 00 00 00 00 02 C7 4A
		15 00 00 00 00 00 02 C8 4B
		15 00 00 00 00 00 02 C9 A6
		15 00 00 00 00 00 02 CA BA
		15 00 00 00 00 00 02 CB CF
		15 00 00 00 00 00 02 CC DA
		15 00 00 00 00 00 02 CD D6
		15 00 00 00 00 00 02 CE C5
		15 00 00 00 00 00 02 CF C7
		15 00 00 00 00 00 02 D0 B4
		15 00 00 00 00 00 02 D1 A2
		15 00 00 00 00 00 02 D2 9B
		15 00 00 00 00 00 02 D3 97
		15 00 00 00 00 00 02 D4 86
		15 00 00 00 00 00 02 D5 3B
		15 00 00 00 00 00 02 D6 3D
		15 00 00 00 00 00 02 D7 3F
		15 00 00 00 00 00 02 D8 41
		15 00 00 00 00 00 02 D9 43
		15 00 00 00 00 00 02 DA 45
		15 00 00 00 00 00 02 DB 47
		15 00 00 00 00 00 02 DC 49
		15 00 00 00 00 00 02 DD 4A
		15 00 00 00 00 00 02 DE 00
		15 01 00 00 00 00 02 DF 00
		//32

		15 00 00 00 00 00 02 83 CC
		15 00 00 00 00 00 02 84 33
		15 00 00 00 00 00 02 91 FF	//Level 63
		
		15 00 00 00 00 00 02 E0 00
		15 00 00 00 00 00 02 E1 00
		15 00 00 00 00 00 02 E2 23
		15 00 00 00 00 00 02 E3 34
		15 00 00 00 00 00 02 E4 42
		15 00 00 00 00 00 02 E5 48
		15 00 00 00 00 00 02 E6 49
		15 00 00 00 00 00 02 E7 4A
		15 00 00 00 00 00 02 E8 4B
		15 00 00 00 00 00 02 E9 A6
		15 00 00 00 00 00 02 EA BA
		15 00 00 00 00 00 02 EB CF
		15 00 00 00 00 00 02 EC DA
		15 00 00 00 00 00 02 ED D6
		15 00 00 00 00 00 02 EE C5
		15 00 00 00 00 00 02 EF C7
		15 00 00 00 00 00 02 F0 B4
		15 00 00 00 00 00 02 F1 A2
		15 00 00 00 00 00 02 F2 9B
		15 00 00 00 00 00 02 F3 97
		15 00 00 00 00 00 02 F4 86
		15 00 00 00 00 00 02 F5 3B
		15 00 00 00 00 00 02 F6 3D
		15 00 00 00 00 00 02 F7 3F
		15 00 00 00 00 00 02 F8 41
		15 00 00 00 00 00 02 F9 43
		15 00 00 00 00 00 02 FA 45
		15 00 00 00 00 00 02 FB 47
		15 00 00 00 00 00 02 FC 49
		15 00 00 00 00 00 02 FD 4A
		15 00 00 00 00 00 02 FE 00
		15 01 00 00 64 00 02 FF 00
		];


		
		qcom,panel-reader-mode-step3-command = [
		15 01 00 00 00 00 02 83 00
		15 01 00 00 00 00 02 84 00
//		15 01 00 00 00 00 02 97 C0  // Set terminal resistor to 75 ohm
		15 01 00 00 00 00 02 8C 8E  // Change HAVDD , V1/V14 , Gamma to register control
		15 01 00 00 00 00 02 CD 6C
		15 01 00 00 00 00 02 C8 FC

		15 01 00 00 00 00 02 FA 12  // Set HAVDD = 4.8V
		15 01 00 00 01 00 02 FD 1B  // Set V1 = 9.4V , V14 = 0.2V
		15 01 00 00 00 00 02 C4 12  // Set STV rising timing
		15 01 00 00 00 00 02 C5 77  // Set STV falling timing
		15 01 00 00 00 00 02 C6 12  // Set GCLK rising timing
		15 01 00 00 00 00 02 C7 77  // Set GCLK falling timing
		15 01 00 00 00 00 02 83 AA
		15 01 00 00 00 00 02 84 11
		15 01 00 00 00 00 02 A9 4B  // Set MIPI Rx ability to solve data loss
		15 01 00 00 00 00 02 A0 36  // Set Slave IC of MIPI D0/D1 lane delay 100ps
		15 01 00 00 00 00 02 A1 3F  // Set Slave IC of MIPI D2/D3 lane delay 150ps
		15 01 00 00 00 00 02 A2 2D  // Set Master IC of MIPI D0/D1 lane delay 50ps
		15 01 00 00 00 00 02 A3 36  // Set Master IC of MIPI D2/D3 lane delay 100ps

/*		
		15 01 00 00 00 00 02 83 00
		15 01 00 00 00 00 02 84 00
		15 01 00 00 00 00 02 8C 04

		15 01 00 00 00 00 02 83 AA
		15 01 00 00 00 00 02 84 11
		15 01 00 00 00 00 02 A9 4B
*/
		//----B Gamma Register----
		//34
		15 00 00 00 00 00 02 83 AA
		15 00 00 00 00 00 02 84 11
		15 00 00 00 00 00 02 C0 00
		15 00 00 00 00 00 02 C1 00
		15 00 00 00 00 00 02 C2 12
		15 00 00 00 00 00 02 C3 17
		15 00 00 00 00 00 02 C4 1E
		15 00 00 00 00 00 02 C5 26
		15 00 00 00 00 00 02 C6 2F
		15 00 00 00 00 00 02 C7 38
		15 00 00 00 00 00 02 C8 41
		15 00 00 00 00 00 02 C9 98
		15 00 00 00 00 00 02 CA A1
		15 00 00 00 00 00 02 CB C0
		15 00 00 00 00 00 02 CC D0
		15 00 00 00 00 00 02 CD DB
		15 00 00 00 00 00 02 CE DF
		15 00 00 00 00 00 02 CF E1
		15 00 00 00 00 00 02 D0 E7
		15 00 00 00 00 00 02 D1 FD
		15 00 00 00 00 00 02 D2 12
		15 00 00 00 00 00 02 D3 35
		15 00 00 00 00 00 02 D4 3F
		15 00 00 00 00 00 02 D5 A9
		15 00 00 00 00 00 02 D6 B1
		15 00 00 00 00 00 02 D7 BA
		15 00 00 00 00 00 02 D8 C3
		15 00 00 00 00 00 02 D9 CD
		15 00 00 00 00 00 02 DA D9
		15 00 00 00 00 00 02 DB E6
		15 00 00 00 00 00 02 DC F6
		15 00 00 00 00 00 02 DD FF
		15 00 00 00 00 00 02 DE 00
		15 01 00 00 00 00 02 DF 0E
		//34		
		15 00 00 00 00 00 02 E0 00
		15 00 00 00 00 00 02 E1 00
		15 00 00 00 00 00 02 E2 12
		15 00 00 00 00 00 02 E3 17
		15 00 00 00 00 00 02 E4 1E
		15 00 00 00 00 00 02 E5 26
		15 00 00 00 00 00 02 E6 2F
		15 00 00 00 00 00 02 E7 38
		15 00 00 00 00 00 02 E8 41
		15 00 00 00 00 00 02 E9 98
		15 00 00 00 00 00 02 EA A1
		15 00 00 00 00 00 02 EB C0
		15 00 00 00 00 00 02 EC D0
		15 00 00 00 00 00 02 ED DB
		15 00 00 00 00 00 02 EE DF
		15 00 00 00 00 00 02 EF E1
		15 00 00 00 00 00 02 F0 E7
		15 00 00 00 00 00 02 F1 FD
		15 00 00 00 00 00 02 F2 12
		15 00 00 00 00 00 02 F3 35
		15 00 00 00 00 00 02 F4 3F
		15 00 00 00 00 00 02 F5 A9
		15 00 00 00 00 00 02 F6 B1
		15 00 00 00 00 00 02 F7 BA
		15 00 00 00 00 00 02 F8 C3
		15 00 00 00 00 00 02 F9 CD
		15 00 00 00 00 00 02 FA D9
		15 00 00 00 00 00 02 FB E6
		15 00 00 00 00 00 02 FC F6
		15 00 00 00 00 00 02 FD FF
		15 00 00 00 00 00 02 FE 00
		15 00 00 00 00 00 02 FF 0E
		//----G Gamma Registe G-a
		15 00 00 00 00 00 02 83 BB
		15 01 00 00 00 00 02 84 22
		//32
		15 00 00 00 00 00 02 C0 00
		15 00 00 00 00 00 02 C1 07
		15 00 00 00 00 00 02 C2 0C
		15 00 00 00 00 00 02 C3 13
		15 00 00 00 00 00 02 C4 1A
		15 00 00 00 00 00 02 C5 22
		15 00 00 00 00 00 02 C6 29
		15 00 00 00 00 00 02 C7 31
		15 00 00 00 00 00 02 C8 39
		15 00 00 00 00 00 02 C9 85
		15 00 00 00 00 00 02 CA 8C
		15 00 00 00 00 00 02 CB A8
		15 00 00 00 00 00 02 CC B7
		15 00 00 00 00 00 02 CD BE
		15 00 00 00 00 00 02 CE BB
		15 00 00 00 00 00 02 CF BC
		15 00 00 00 00 00 02 D0 B7
		15 00 00 00 00 00 02 D1 B6
		15 00 00 00 00 00 02 D2 BA
		15 00 00 00 00 00 02 D3 C2
		15 00 00 00 00 00 02 D4 B8
		15 00 00 00 00 00 02 D5 58
		15 00 00 00 00 00 02 D6 5B
		15 00 00 00 00 00 02 D7 5E
		15 00 00 00 00 00 02 D8 62
		15 00 00 00 00 00 02 D9 65
		15 00 00 00 00 00 02 DA 69
		15 00 00 00 00 00 02 DB 6C
		15 00 00 00 00 00 02 DC 70
		15 00 00 00 00 00 02 DD 72
		15 00 00 00 00 00 02 DE 00
		15 01 00 00 00 00 02 DF 00
		//34
		15 00 00 00 00 00 02 E0 00
		15 00 00 00 00 00 02 E1 07
		15 00 00 00 00 00 02 E2 0C
		15 00 00 00 00 00 02 E3 13
		15 00 00 00 00 00 02 E4 1A
		15 00 00 00 00 00 02 E5 22
		15 00 00 00 00 00 02 E6 29
		15 00 00 00 00 00 02 E7 31
		15 00 00 00 00 00 02 E8 39
		15 00 00 00 00 00 02 E9 85
		15 00 00 00 00 00 02 EA 8C
		15 00 00 00 00 00 02 EB A8
		15 00 00 00 00 00 02 EC B7
		15 00 00 00 00 00 02 ED BE
		15 00 00 00 00 00 02 EE BB
		15 00 00 00 00 00 02 EF BC
		15 00 00 00 00 00 02 F0 B7
		15 00 00 00 00 00 02 F1 B6
		15 00 00 00 00 00 02 F2 BA
		15 00 00 00 00 00 02 F3 C2
		15 00 00 00 00 00 02 F4 B8
		15 00 00 00 00 00 02 F5 58
		15 00 00 00 00 00 02 F6 5B
		15 00 00 00 00 00 02 F7 5E
		15 00 00 00 00 00 02 F8 62
		15 00 00 00 00 00 02 F9 65
		15 00 00 00 00 00 02 FA 69
		15 00 00 00 00 00 02 FB 6C
		15 00 00 00 00 00 02 FC 70
		15 00 00 00 00 00 02 FD 72
		15 00 00 00 00 00 02 FE 00
		15 00 00 00 00 00 02 FF 00
		//----R Gamma Registe G-a
		15 00 00 00 00 00 02 83 CC
		15 01 00 00 00 00 02 84 33
		//32
		15 00 00 00 00 00 02 C0 00
		15 00 00 00 00 00 02 C1 00
		15 00 00 00 00 00 02 C2 0C
		15 00 00 00 00 00 02 C3 0F
		15 00 00 00 00 00 02 C4 14
		15 00 00 00 00 00 02 C5 1C
		15 00 00 00 00 00 02 C6 20
		15 00 00 00 00 00 02 C7 22
		15 00 00 00 00 00 02 C8 23
		15 00 00 00 00 00 02 C9 48
		15 00 00 00 00 00 02 CA 5F
		15 00 00 00 00 00 02 CB 86
		15 00 00 00 00 00 02 CC 98
		15 00 00 00 00 00 02 CD 9E
		15 00 00 00 00 00 02 CE 96
		15 00 00 00 00 00 02 CF 98
		15 00 00 00 00 00 02 D0 8A
		15 00 00 00 00 00 02 D1 7D
		15 00 00 00 00 00 02 D2 77
		15 00 00 00 00 00 02 D3 73
		15 00 00 00 00 00 02 D4 62
		15 00 00 00 00 00 02 D5 28
		15 00 00 00 00 00 02 D6 2A
		15 00 00 00 00 00 02 D7 2C
		15 00 00 00 00 00 02 D8 2E
		15 00 00 00 00 00 02 D9 30
		15 00 00 00 00 00 02 DA 32
		15 00 00 00 00 00 02 DB 35
		15 00 00 00 00 00 02 DC 37
		15 00 00 00 00 00 02 DD 38
		15 00 00 00 00 00 02 DE 00
		15 01 00 00 00 00 02 DF 00
		//32
		15 00 00 00 00 00 02 E0 00
		15 00 00 00 00 00 02 E1 00
		15 00 00 00 00 00 02 E2 0C
		15 00 00 00 00 00 02 E3 0F
		15 00 00 00 00 00 02 E4 14
		15 00 00 00 00 00 02 E5 1C
		15 00 00 00 00 00 02 E6 20
		15 00 00 00 00 00 02 E7 22
		15 00 00 00 00 00 02 E8 23
		15 00 00 00 00 00 02 E9 48
		15 00 00 00 00 00 02 EA 5F
		15 00 00 00 00 00 02 EB 86
		15 00 00 00 00 00 02 EC 98
		15 00 00 00 00 00 02 ED 9E
		15 00 00 00 00 00 02 EE 96
		15 00 00 00 00 00 02 EF 98
		15 00 00 00 00 00 02 F0 8A
		15 00 00 00 00 00 02 F1 7D
		15 00 00 00 00 00 02 F2 77
		15 00 00 00 00 00 02 F3 73
		15 00 00 00 00 00 02 F4 62
		15 00 00 00 00 00 02 F5 28
		15 00 00 00 00 00 02 F6 2A
		15 00 00 00 00 00 02 F7 2C
		15 00 00 00 00 00 02 F8 2E
		15 00 00 00 00 00 02 F9 30
		15 00 00 00 00 00 02 FA 32
		15 00 00 00 00 00 02 FB 35
		15 00 00 00 00 00 02 FC 37
		15 00 00 00 00 00 02 FD 38
		15 00 00 00 00 00 02 FE 00
		15 01 00 00 64 00 02 FF 00
		];



		qcom,panel-reader-mode-off-command = [
		15 01 00 00 00 00 02 83 00
		15 01 00 00 00 00 02 84 00
//		15 01 00 00 00 00 02 97 C0  // Set terminal resistor to 75 ohm
		15 01 00 00 00 00 02 8C 8E  // Change HAVDD , V1/V14 , Gamma to register control
		15 01 00 00 00 00 02 CD 6C
		15 01 00 00 00 00 02 C8 FC

		15 01 00 00 00 00 02 FA 12  // Set HAVDD = 4.8V
		15 01 00 00 01 00 02 FD 1B  // Set V1 = 9.4V , V14 = 0.2V
		15 01 00 00 00 00 02 C4 12  // Set STV rising timing
		15 01 00 00 00 00 02 C5 77  // Set STV falling timing
		15 01 00 00 00 00 02 C6 12  // Set GCLK rising timing
		15 01 00 00 00 00 02 C7 77  // Set GCLK falling timing
		15 01 00 00 00 00 02 83 AA
		15 01 00 00 00 00 02 84 11
		15 01 00 00 00 00 02 A9 4B  // Set MIPI Rx ability to solve data loss
		15 01 00 00 00 00 02 A0 36  // Set Slave IC of MIPI D0/D1 lane delay 100ps
		15 01 00 00 00 00 02 A1 3F  // Set Slave IC of MIPI D2/D3 lane delay 150ps
		15 01 00 00 00 00 02 A2 2D  // Set Master IC of MIPI D0/D1 lane delay 50ps
		15 01 00 00 00 00 02 A3 36  // Set Master IC of MIPI D2/D3 lane delay 100ps

/*		
		15 01 00 00 00 00 02 83 00
		15 01 00 00 00 00 02 84 00
		15 01 00 00 00 00 02 8C 04

		15 01 00 00 00 00 02 83 AA
		15 01 00 00 00 00 02 84 11
		15 01 00 00 00 00 02 A9 4B
*/		
		//----R Gamma Register--
		15 00 00 00 00 00 02 83 AA
		15 00 00 00 00 00 02 84 11
		15 00 00 00 00 00 02 C0 0E
		15 00 00 00 00 00 02 C1 12
		15 00 00 00 00 00 02 C2 25
		15 00 00 00 00 00 02 C3 36
		15 00 00 00 00 00 02 C4 42
		15 00 00 00 00 00 02 C5 4B
		15 00 00 00 00 00 02 C6 57
		15 00 00 00 00 00 02 C7 60
		15 00 00 00 00 00 02 C8 69
		15 00 00 00 00 00 02 C9 DB
		15 00 00 00 00 00 02 CA DF
		15 00 00 00 00 00 02 CB F5
		15 00 00 00 00 00 02 CC FE		
		15 00 00 00 00 00 02 CD FC		
		15 00 00 00 00 00 02 CE F7
		15 00 00 00 00 00 02 CF F9
		15 00 00 00 00 00 02 D0 FB
		15 00 00 00 00 00 02 D1 0A
		15 00 00 00 00 00 02 D2 1F
		15 00 00 00 00 00 02 D3 40
		15 00 00 00 00 00 02 D4 4A
		15 00 00 00 00 00 02 D5 AE
		15 00 00 00 00 00 02 D6 B0
		15 00 00 00 00 00 02 D7 BB
		15 00 00 00 00 00 02 D8 C5
		15 00 00 00 00 00 02 D9 CE
		15 00 00 00 00 00 02 DA D8
		15 00 00 00 00 00 02 DB E7
		15 00 00 00 00 00 02 DC F0
		15 00 00 00 00 00 02 DD FF
		15 00 00 00 00 00 02 DE 00
		15 01 00 00 00 00 02 DF 2F				
		15 00 00 00 00 00 02 E0 0E			
		15 00 00 00 00 00 02 E1 12
		15 00 00 00 00 00 02 E2 25
		15 00 00 00 00 00 02 E3 36
		15 00 00 00 00 00 02 E4 42
		15 00 00 00 00 00 02 E5 4B
		15 00 00 00 00 00 02 E6 57
		15 00 00 00 00 00 02 E7 60
		15 00 00 00 00 00 02 E8 69
		15 00 00 00 00 00 02 E9 DB
		15 00 00 00 00 00 02 EA DF
		15 00 00 00 00 00 02 EB F5
		15 00 00 00 00 00 02 EC FE
		15 00 00 00 00 00 02 ED FC
		15 00 00 00 00 00 02 EE F7
		15 00 00 00 00 00 02 EF F9		
		15 00 00 00 00 00 02 F0 FB
		15 00 00 00 00 00 02 F1 0A
		15 00 00 00 00 00 02 F2 1F
		15 00 00 00 00 00 02 F3 40
		15 00 00 00 00 00 02 F4 4A
		15 00 00 00 00 00 02 F5 AE			
		15 00 00 00 00 00 02 F6 B0
		15 00 00 00 00 00 02 F7 BB
		15 00 00 00 00 00 02 F8 C5
		15 00 00 00 00 00 02 F9 CE
		15 00 00 00 00 00 02 FA D8
		15 00 00 00 00 00 02 FB E7
		15 00 00 00 00 00 02 FC F0
		15 00 00 00 00 00 02 FD FF
		15 00 00 00 00 00 02 FE 00
		15 00 00 00 00 00 02 FF 2F		
		//----G Gamma Register--a 
		15 00 00 00 00 00 02 83 BB		
		15 01 00 00 00 00 02 84 22		
		15 00 00 00 00 00 02 C0 0E
		15 00 00 00 00 00 02 C1 12
		15 00 00 00 00 00 02 C2 25
		15 00 00 00 00 00 02 C3 36
		15 00 00 00 00 00 02 C4 42
		15 00 00 00 00 00 02 C5 4B
		15 00 00 00 00 00 02 C6 57
		15 00 00 00 00 00 02 C7 60
		15 00 00 00 00 00 02 C8 69
		15 00 00 00 00 00 02 C9 DB
		15 00 00 00 00 00 02 CA DF
		15 00 00 00 00 00 02 CB F5
		15 00 00 00 00 00 02 CC FE
		15 00 00 00 00 00 02 CD FC		
		15 00 00 00 00 00 02 CE F7
		15 00 00 00 00 00 02 CF F9
		15 00 00 00 00 00 02 D0 FB
		15 00 00 00 00 00 02 D1 0A
		15 00 00 00 00 00 02 D2 1F
		15 00 00 00 00 00 02 D3 40
		15 00 00 00 00 00 02 D4 4A
		15 00 00 00 00 00 02 D5 AE
		15 00 00 00 00 00 02 D6 B0
		15 00 00 00 00 00 02 D7 BB
		15 00 00 00 00 00 02 D8 C5
		15 00 00 00 00 00 02 D9 CE
		15 00 00 00 00 00 02 DA D8
		15 00 00 00 00 00 02 DB E7
		15 00 00 00 00 00 02 DC F0
		15 00 00 00 00 00 02 DD FF
		15 00 00 00 00 00 02 DE 00
		15 01 00 00 00 00 02 DF 2F
		15 00 00 00 00 00 02 E0 0E
		15 00 00 00 00 00 02 E1 12				
		15 00 00 00 00 00 02 E2 25
		15 00 00 00 00 00 02 E3 36
		15 00 00 00 00 00 02 E4 42
		15 00 00 00 00 00 02 E5 4B
		15 00 00 00 00 00 02 E6 57
		15 00 00 00 00 00 02 E7 60
		15 00 00 00 00 00 02 E8 69
		15 00 00 00 00 00 02 E9 DB
		15 00 00 00 00 00 02 EA DF
		15 00 00 00 00 00 02 EB F5		
		15 00 00 00 00 00 02 EC FE
		15 00 00 00 00 00 02 ED FC						
		15 00 00 00 00 00 02 EE F7
		15 00 00 00 00 00 02 EF F9						
		15 00 00 00 00 00 02 F0 FB
		15 00 00 00 00 00 02 F1 0A
		15 00 00 00 00 00 02 F2 1F
		15 00 00 00 00 00 02 F3 40
		15 00 00 00 00 00 02 F4 4A
		15 00 00 00 00 00 02 F5 AE
		15 00 00 00 00 00 02 F6 B0
		15 00 00 00 00 00 02 F7 BB
		15 00 00 00 00 00 02 F8 C5
		15 00 00 00 00 00 02 F9 CE
		15 00 00 00 00 00 02 FA D8
		15 00 00 00 00 00 02 FB E7
		15 00 00 00 00 00 02 FC F0
		15 00 00 00 00 00 02 FD FF
		15 00 00 00 00 00 02 FE 00
		15 00 00 00 00 00 02 FF 2F
		//----B Gamma Register--a 
		15 00 00 00 00 00 02 83 CC		
		15 01 00 00 00 00 02 84 33
		15 00 00 00 00 00 02 C0 0E
		15 00 00 00 00 00 02 C1 12
		15 00 00 00 00 00 02 C2 25
		15 00 00 00 00 00 02 C3 36
		15 00 00 00 00 00 02 C4 42
		15 00 00 00 00 00 02 C5 4B
		15 00 00 00 00 00 02 C6 57
		15 00 00 00 00 00 02 C7 60
		15 00 00 00 00 00 02 C8 69
		15 00 00 00 00 00 02 C9 DB
		15 00 00 00 00 00 02 CA DF
		15 00 00 00 00 00 02 CB F5
		15 00 00 00 00 00 02 CC FE
		15 00 00 00 00 00 02 CD FC			
		15 00 00 00 00 00 02 CE F7
		15 00 00 00 00 00 02 CF F9
		15 00 00 00 00 00 02 D0 FB
		15 00 00 00 00 00 02 D1 0A
		15 00 00 00 00 00 02 D2 1F
		15 00 00 00 00 00 02 D3 40
		15 00 00 00 00 00 02 D4 4A
		15 00 00 00 00 00 02 D5 AE
		15 00 00 00 00 00 02 D6 B0				
		15 00 00 00 00 00 02 D7 BB
		15 00 00 00 00 00 02 D8 C5
		15 00 00 00 00 00 02 D9 CE
		15 00 00 00 00 00 02 DA D8
		15 00 00 00 00 00 02 DB E7
		15 00 00 00 00 00 02 DC F0
		15 00 00 00 00 00 02 DD FF
		15 00 00 00 00 00 02 DE 00
		15 01 00 00 00 00 02 DF 2F	
		15 00 00 00 00 00 02 E0 0E
		15 00 00 00 00 00 02 E1 12		
		15 00 00 00 00 00 02 E2 25
		15 00 00 00 00 00 02 E3 36
		15 00 00 00 00 00 02 E4 42
		15 00 00 00 00 00 02 E5 4B
		15 00 00 00 00 00 02 E6 57
		15 00 00 00 00 00 02 E7 60
		15 00 00 00 00 00 02 E8 69
		15 00 00 00 00 00 02 E9 DB
		15 00 00 00 00 00 02 EA DF				
		15 00 00 00 00 00 02 EB F5
		15 00 00 00 00 00 02 EC FE
		15 00 00 00 00 00 02 ED FC				
		15 00 00 00 00 00 02 EE F7
		15 00 00 00 00 00 02 EF F9
		15 00 00 00 00 00 02 F0 FB
		15 00 00 00 00 00 02 F1 0A
		15 00 00 00 00 00 02 F2 1F
		15 00 00 00 00 00 02 F3 40
		15 00 00 00 00 00 02 F4 4A
		15 00 00 00 00 00 02 F5 AE
		15 00 00 00 00 00 02 F6 B0
		15 00 00 00 00 00 02 F7 BB
		15 00 00 00 00 00 02 F8 C5
		15 00 00 00 00 00 02 F9 CE
		15 00 00 00 00 00 02 FA D8
		15 00 00 00 00 00 02 FB E7
		15 00 00 00 00 00 02 FC F0
		15 00 00 00 00 00 02 FD FF
		15 00 00 00 00 00 02 FE 00
		15 01 00 00 64 00 02 FF 2F
		];

		qcom,panel-reader-mode-mono-off-command = [
		15 01 00 00 00 00 02 83 00
		15 01 00 00 00 00 02 84 00
//		15 01 00 00 00 00 02 97 C0  // Set terminal resistor to 75 ohm
		15 01 00 00 00 00 02 8C 8E  // Change HAVDD , V1/V14 , Gamma to register control
		15 01 00 00 00 00 02 CD 6C
		15 01 00 00 00 00 02 C8 FC

		15 01 00 00 00 00 02 FA 12  // Set HAVDD = 4.8V
		15 01 00 00 01 00 02 FD 1B  // Set V1 = 9.4V , V14 = 0.2V
		15 01 00 00 00 00 02 C4 12  // Set STV rising timing
		15 01 00 00 00 00 02 C5 77  // Set STV falling timing
		15 01 00 00 00 00 02 C6 12  // Set GCLK rising timing
		15 01 00 00 00 00 02 C7 77  // Set GCLK falling timing
		15 01 00 00 00 00 02 83 AA
		15 01 00 00 00 00 02 84 11
		15 01 00 00 00 00 02 A9 4B  // Set MIPI Rx ability to solve data loss
		15 01 00 00 00 00 02 A0 36  // Set Slave IC of MIPI D0/D1 lane delay 100ps
		15 01 00 00 00 00 02 A1 3F  // Set Slave IC of MIPI D2/D3 lane delay 150ps
		15 01 00 00 00 00 02 A2 2D  // Set Master IC of MIPI D0/D1 lane delay 50ps
		15 01 00 00 00 00 02 A3 36  // Set Master IC of MIPI D2/D3 lane delay 100ps

/*		
		15 01 00 00 00 00 02 83 00
		15 01 00 00 00 00 02 84 00
		15 01 00 00 00 00 02 8C 04
		
		15 01 00 00 00 00 02 83 AA
		15 01 00 00 00 00 02 84 11
		15 01 00 00 00 00 02 A9 4B
*/		
		15 00 00 00 00 00 02 83 CC
		15 00 00 00 00 00 02 84 33
		15 00 00 00 00 00 02 91 F5	//Level 53
		
		//34				
		//change page1
		15 00 00 00 00 00 02 83 AA
		15 00 00 00 00 00 02 84 11
		//----R Gamma Register----
		15 00 00 00 00 00 02 C0 0E
		15 00 00 00 00 00 02 C1 12
		15 00 00 00 00 00 02 C2 25
		15 00 00 00 00 00 02 C3 36
		15 00 00 00 00 00 02 C4 42
		15 00 00 00 00 00 02 C5 4B
		15 00 00 00 00 00 02 C6 57
		15 00 00 00 00 00 02 C7 60
		15 00 00 00 00 00 02 C8 69
		15 00 00 00 00 00 02 C9 DB
		15 00 00 00 00 00 02 CA DF
		15 00 00 00 00 00 02 CB F5
		15 00 00 00 00 00 02 CC FE		
		15 00 00 00 00 00 02 CD FC		
		15 00 00 00 00 00 02 CE F7
		15 00 00 00 00 00 02 CF F9
		15 00 00 00 00 00 02 D0 FB
		15 00 00 00 00 00 02 D1 0A
		15 00 00 00 00 00 02 D2 1F
		15 00 00 00 00 00 02 D3 40
		15 00 00 00 00 00 02 D4 4A
		15 00 00 00 00 00 02 D5 AE
		15 00 00 00 00 00 02 D6 B0
		15 00 00 00 00 00 02 D7 BB
		15 00 00 00 00 00 02 D8 C5
		15 00 00 00 00 00 02 D9 CE
		15 00 00 00 00 00 02 DA D8
		15 00 00 00 00 00 02 DB E7
		15 00 00 00 00 00 02 DC F0
		15 00 00 00 00 00 02 DD FF
		15 00 00 00 00 00 02 DE 00
		15 01 00 00 00 00 02 DF 2F				
				
		//34
		15 00 00 00 00 00 02 83 CC
		15 00 00 00 00 00 02 84 33
		15 00 00 00 00 00 02 91 EB	//Level 43

		15 00 00 00 00 00 02 83 AA
		15 00 00 00 00 00 02 84 11
		
		15 00 00 00 00 00 02 E0 0E			
		15 00 00 00 00 00 02 E1 12
		15 00 00 00 00 00 02 E2 25
		15 00 00 00 00 00 02 E3 36
		15 00 00 00 00 00 02 E4 42
		15 00 00 00 00 00 02 E5 4B
		15 00 00 00 00 00 02 E6 57
		15 00 00 00 00 00 02 E7 60
		15 00 00 00 00 00 02 E8 69
		15 00 00 00 00 00 02 E9 DB
		15 00 00 00 00 00 02 EA DF
		15 00 00 00 00 00 02 EB F5
		15 00 00 00 00 00 02 EC FE
		15 00 00 00 00 00 02 ED FC
		15 00 00 00 00 00 02 EE F7
		15 00 00 00 00 00 02 EF F9		
		15 00 00 00 00 00 02 F0 FB
		15 00 00 00 00 00 02 F1 0A
		15 00 00 00 00 00 02 F2 1F
		15 00 00 00 00 00 02 F3 40
		15 00 00 00 00 00 02 F4 4A
		15 00 00 00 00 00 02 F5 AE			
		15 00 00 00 00 00 02 F6 B0
		15 00 00 00 00 00 02 F7 BB
		15 00 00 00 00 00 02 F8 C5
		15 00 00 00 00 00 02 F9 CE
		15 00 00 00 00 00 02 FA D8
		15 00 00 00 00 00 02 FB E7
		15 00 00 00 00 00 02 FC F0
		15 00 00 00 00 00 02 FD FF
		15 00 00 00 00 00 02 FE 00
		15 01 00 00 00 00 02 FF 2F		
		
		15 00 00 00 00 00 02 83 CC
		15 00 00 00 00 00 02 84 33
		15 00 00 00 00 00 02 91 E1	//Level 33

		//change page 2		
		15 00 00 00 00 00 02 83 BB		
		15 00 00 00 00 00 02 84 22		
		//----G Gamma Register----
		
		//32
		15 00 00 00 00 00 02 C0 0E
		15 00 00 00 00 00 02 C1 12
		15 00 00 00 00 00 02 C2 25
		15 00 00 00 00 00 02 C3 36
		15 00 00 00 00 00 02 C4 42
		15 00 00 00 00 00 02 C5 4B
		15 00 00 00 00 00 02 C6 57
		15 00 00 00 00 00 02 C7 60
		15 00 00 00 00 00 02 C8 69
		15 00 00 00 00 00 02 C9 DB
		15 00 00 00 00 00 02 CA DF
		15 00 00 00 00 00 02 CB F5
		15 00 00 00 00 00 02 CC FE
		15 00 00 00 00 00 02 CD FC		
		15 00 00 00 00 00 02 CE F7
		15 00 00 00 00 00 02 CF F9
		15 00 00 00 00 00 02 D0 FB
		15 00 00 00 00 00 02 D1 0A
		15 00 00 00 00 00 02 D2 1F
		15 00 00 00 00 00 02 D3 40
		15 00 00 00 00 00 02 D4 4A
		15 00 00 00 00 00 02 D5 AE
		15 00 00 00 00 00 02 D6 B0
		15 00 00 00 00 00 02 D7 BB
		15 00 00 00 00 00 02 D8 C5
		15 00 00 00 00 00 02 D9 CE
		15 00 00 00 00 00 02 DA D8
		15 00 00 00 00 00 02 DB E7
		15 00 00 00 00 00 02 DC F0
		15 00 00 00 00 00 02 DD FF
		15 00 00 00 00 00 02 DE 00
		15 01 00 00 00 00 02 DF 2F

		15 00 00 00 00 00 02 83 CC
		15 00 00 00 00 00 02 84 33
		15 00 00 00 00 00 02 91 D7	//Level 23

		//change page 2		
		15 00 00 00 00 00 02 83 BB		
		15 00 00 00 00 00 02 84 22
		
		//34	
		15 00 00 00 00 00 02 E0 0E
		15 00 00 00 00 00 02 E1 12				
		15 00 00 00 00 00 02 E2 25
		15 00 00 00 00 00 02 E3 36
		15 00 00 00 00 00 02 E4 42
		15 00 00 00 00 00 02 E5 4B
		15 00 00 00 00 00 02 E6 57
		15 00 00 00 00 00 02 E7 60
		15 00 00 00 00 00 02 E8 69
		15 00 00 00 00 00 02 E9 DB
		15 00 00 00 00 00 02 EA DF
		15 00 00 00 00 00 02 EB F5		
		15 00 00 00 00 00 02 EC FE
		15 00 00 00 00 00 02 ED FC						
		15 00 00 00 00 00 02 EE F7
		15 00 00 00 00 00 02 EF F9						
		15 00 00 00 00 00 02 F0 FB
		15 00 00 00 00 00 02 F1 0A
		15 00 00 00 00 00 02 F2 1F
		15 00 00 00 00 00 02 F3 40
		15 00 00 00 00 00 02 F4 4A
		15 00 00 00 00 00 02 F5 AE
		15 00 00 00 00 00 02 F6 B0
		15 00 00 00 00 00 02 F7 BB
		15 00 00 00 00 00 02 F8 C5
		15 00 00 00 00 00 02 F9 CE
		15 00 00 00 00 00 02 FA D8
		15 00 00 00 00 00 02 FB E7
		15 00 00 00 00 00 02 FC F0
		15 00 00 00 00 00 02 FD FF
		15 00 00 00 00 00 02 FE 00
		15 00 00 00 00 00 02 FF 2F
		//change page 3		
		15 00 00 00 00 00 02 83 CC		
		15 01 00 00 00 00 02 84 33
		//----B Gamma Register----

		15 00 00 00 00 00 02 83 CC
		15 00 00 00 00 00 02 84 33
		15 00 00 00 00 00 02 91 CD	//Level 13
		
		//32
		15 00 00 00 00 00 02 C0 0E
		15 00 00 00 00 00 02 C1 12
		15 00 00 00 00 00 02 C2 25
		15 00 00 00 00 00 02 C3 36
		15 00 00 00 00 00 02 C4 42
		15 00 00 00 00 00 02 C5 4B
		15 00 00 00 00 00 02 C6 57
		15 00 00 00 00 00 02 C7 60
		15 00 00 00 00 00 02 C8 69
		15 00 00 00 00 00 02 C9 DB
		15 00 00 00 00 00 02 CA DF
		15 00 00 00 00 00 02 CB F5
		15 00 00 00 00 00 02 CC FE
		15 00 00 00 00 00 02 CD FC			
		15 00 00 00 00 00 02 CE F7
		15 00 00 00 00 00 02 CF F9
		15 00 00 00 00 00 02 D0 FB
		15 00 00 00 00 00 02 D1 0A
		15 00 00 00 00 00 02 D2 1F
		15 00 00 00 00 00 02 D3 40
		15 00 00 00 00 00 02 D4 4A
		15 00 00 00 00 00 02 D5 AE
		15 00 00 00 00 00 02 D6 B0				
		15 00 00 00 00 00 02 D7 BB
		15 00 00 00 00 00 02 D8 C5
		15 00 00 00 00 00 02 D9 CE
		15 00 00 00 00 00 02 DA D8
		15 00 00 00 00 00 02 DB E7
		15 00 00 00 00 00 02 DC F0
		15 00 00 00 00 00 02 DD FF
		15 00 00 00 00 00 02 DE 00
		15 01 00 00 00 00 02 DF 2F	

		15 00 00 00 00 00 02 83 CC
		15 00 00 00 00 00 02 84 33
		15 00 00 00 00 00 02 90 10	//CE OFF
		
		//32		
		15 00 00 00 00 00 02 E0 0E
		15 00 00 00 00 00 02 E1 12		
		15 00 00 00 00 00 02 E2 25
		15 00 00 00 00 00 02 E3 36
		15 00 00 00 00 00 02 E4 42
		15 00 00 00 00 00 02 E5 4B
		15 00 00 00 00 00 02 E6 57
		15 00 00 00 00 00 02 E7 60
		15 00 00 00 00 00 02 E8 69
		15 00 00 00 00 00 02 E9 DB
		15 00 00 00 00 00 02 EA DF				
		15 00 00 00 00 00 02 EB F5
		15 00 00 00 00 00 02 EC FE
		15 00 00 00 00 00 02 ED FC				
		15 00 00 00 00 00 02 EE F7
		15 00 00 00 00 00 02 EF F9
		15 00 00 00 00 00 02 F0 FB
		15 00 00 00 00 00 02 F1 0A
		15 00 00 00 00 00 02 F2 1F
		15 00 00 00 00 00 02 F3 40
		15 00 00 00 00 00 02 F4 4A
		15 00 00 00 00 00 02 F5 AE
		15 00 00 00 00 00 02 F6 B0
		15 00 00 00 00 00 02 F7 BB
		15 00 00 00 00 00 02 F8 C5
		15 00 00 00 00 00 02 F9 CE
		15 00 00 00 00 00 02 FA D8
		15 00 00 00 00 00 02 FB E7
		15 00 00 00 00 00 02 FC F0
		15 00 00 00 00 00 02 FD FF
		15 00 00 00 00 00 02 FE 00
		15 01 00 00 64 00 02 FF 2F

		];

		qcom,panel-reader-mode-mono-enable-command = [
		// Page switch
		15 01 00 00 00 00 02 83 CC
		15 01 00 00 00 00 02 84 33
		// Color enhance enable
		15 01 00 00 00 00 02 90 11
		// De-saturation level
		15 01 00 00 00 00 02 91 FF
		];

		qcom,panel-reader-mode-mono-disable-command = [
		// Page switch
		15 01 00 00 00 00 02 83 CC
		15 01 00 00 00 00 02 84 33
		// Color enhance enable
		15 01 00 00 00 00 02 90 10
		];

/*
		qcom,panel-charging-time-on-command = [
		15 01 00 00 00 00 02 83 00
		15 01 00 00 00 00 02 84 00
		15 01 00 00 00 00 02 C7 A6
		];

		qcom,panel-charging-time-off-command = [
		15 01 00 00 00 00 02 83 00
		15 01 00 00 00 00 02 84 00
		15 01 00 00 00 00 02 C7 77
		];
*/
		
/*
		//CABC still mode
		qcom,panel-cabc-still-command = [
		// Page switch
		15 01 00 00 00 00 02 83 BB
		15 01 00 00 00 00 02 84 22
		// CABC still mode
		15 01 00 00 00 00 02 90 40
		];
*/
		qcom,mdss-dsi-on-command-state = "dsi_lp_mode";
		qcom,mdss-dsi-off-command-state = "dsi_hs_mode";
		qcom,mdss-pan-physical-width-dimension = <135>;
		qcom,mdss-pan-physical-height-dimension = <216>;
		qcom,mdss-dsi-h-sync-pulse = <0>;
		qcom,mdss-dsi-traffic-mode = "non_burst_sync_event";
		qcom,mdss-dsi-lane-map = "lane_map_0123";
		qcom,mdss-dsi-bllp-eof-power-mode;
		qcom,mdss-dsi-bllp-power-mode;
		qcom,mdss-dsi-lane-0-state;
		qcom,mdss-dsi-lane-1-state;
		qcom,mdss-dsi-lane-2-state;
		qcom,mdss-dsi-lane-3-state;
		qcom,mdss-dsi-panel-timings = [03 3E 2A 01 72 76 2E 42 4C 03 04 00];	//999Mhz
		qcom,mdss-dsi-t-clk-post = <0x02>;
		qcom,mdss-dsi-t-clk-pre = <0x32>;
		qcom,mdss-dsi-dma-trigger = "trigger_sw";
		qcom,mdss-dsi-mdp-trigger = "none";
		qcom,mdss-dsi-pan-enable-dynamic-fps;
		qcom,mdss-dsi-pan-fps-update = "dfps_immediate_porch_mode_vfp";
		qcom,mdss-dsi-min-refresh-rate = <48>;
		qcom,off-cmds-dsi-state = "dsi_hs_mode";
		lge,charging-time-command;

		lge,panel_power_sequence = <
			0    /*pre_msm_dss_enable_vreg*/
			0    /*post_msm_dss_enable_vreg*/
			0    /*pre_mdss_dsi_panel_reset*/
			0    /*post_mdss_dsi_panel_reset*/
			0    /*pre_mdss_dsi_panel_power_ctrl*/
			0    /*post_mdss_dsi_panel_power_ctrl*/
			0    /*post_mdss_dsi_blank*/
			0    /*post_mdss_dsi_panel_on*/
			0    /*post_mdss_dsi_panel_off*/
			0    /*lge_mdss_dsi_event_handler*/
			0    /*lge_msm_dss_enable_vreg*/
			0    /*lge_mdss_dsi_request_gpios*/
			0    /*lge_mdss_dsi_panel_reset*/
			0    /*lge_mdss_dsi_lane_config*/
			0    /*lge_mdss_dsi_ctrl_probe*/
			0    /*lge_dsi_panel_device_register*/
			0    /*lge_mdss_panel_parse_dt*/
			0    /*lge_panel_device_create*/
			0    /*lge_mdss_dsi_cmdlist_commit*/
			1    /*lge_mdss_dsi_panel_init*/
			0    /*lge_dump_mdss_reg*/
			0    /*lge_mdss_xlog_tout_handler_default*/
			0    /*lge_mdss_create_xlog_debug*/
			0    /*lge_mdss_dsi_panel_bl_ctrl*/
			>;

		lge,blmap-size = <256>;
		lge,blmap = <
			0 45 45 45 45 45 45 45 45 45                            /* 0 ~ 9 */
			45 47 49 51 53 55 57 59 61 63                           /* 10 ~ 19 */
			65 67 69 71 73 75 77 79 81 84                           /* 20 ~ 29 */
			86 88 90 92 94 97 98 100 102 104                                   /* 30 ~ 39 */
			106 108 110 111 113 115 117 119 121 123                         /* 40 ~ 49 */
			125 128 131 133 136 140 145 150 150 150                         /* 50 ~ 59 */
			150 150 157 170 182 189 195 202 208 215                         /* 60 ~ 69 */
			221 228 234 241 248 256 263 271 278 286                         /* 70 ~ 79 */
			294 301 309 316 324 332 339 346 353 360                         /* 80 ~ 89 */
			367 374 381 388 395 402 409 416 423 431                         /* 90 ~ 99 */
			439 448 456 464 473 481 495 515 515 515                         /* 100 ~ 109 */
			515 515 540 567 580 593 607 620 633 646                         /* 110 ~ 119 */
			659 672 686 700 714 728 743 757 771 785                         /* 120 ~ 129 */
			800 814 828 842 857 872 888 903 919 934                         /* 130 ~ 139 */
			950 965 981 996 1012 1028 1041 1054 1067 1080                 /* 140 ~ 149 */
			1094 1107 1120 1133 1147 1160 1180 1200 1200 1200           /* 150 ~ 159 */
			1224 1250 1278 1305 1332 1354 1376 1398 1420 1450           /* 160 ~ 169 */
			1450 1450 1450 1450 1500 1566 1587 1607 1628 1648           /* 170 ~ 179 */
			1668 1689 1709 1730 1752 1774 1796 1818 1840 1862           /* 180 ~ 189 */
			1884 1906 1928 1950 1972 1995 2015 2035 2056 2076           /* 190 ~ 199 */
			2096 2117 2137 2158 2178 2198 2260 2260 2260 2260           /* 200 ~ 209 */
			2260 2321 2395 2429 2462 2496 2530 2564 2598 2632           /* 210 ~ 219 */
			2660 2689 2717 2746 2775 2803 2832 2860 2889 2918           /* 220 ~ 229 */
			2946 2975 3004 3035 3066 3097 3128 3159 3190 3221           /* 230 ~ 239 */
			3252 3283 3314 3345 3376 3410 3444 3478 3512 3546           /* 240 ~ 249 */
			3580 3614 3648 3682 3716 3750>;                                   /* 250 ~ 255 */
	};
};

