/* Copyright (c) 2014, Code Aurora Forum. All rights reserved.
 *
 * This program is free software; you can redistribute it and/or modify
 * it under the terms of the GNU General Public License version 2 and
 * only version 2 as published by the Free Software Foundation.
 *
 * This program is distributed in the hope that it will be useful,
 * but WITHOUT ANY WARRANTY; without even the implied warranty of
 * MERCHANTABILITY or FITNESS FOR A PARTICULAR PURPOSE.  See the
 * GNU General Public License for more details.
 */

&mdss_mdp {
	dsi_sharp_nt35596_vid: qcom,mdss_dsi_sharp_nt35596_fhd_video {
		compatible = "qcom,mdss-dsi-panel";
		qcom,mdss-dsi-panel-name = "SHARP FHD video mode dsi panel";
		qcom,mdss-dsi-panel-controller = <&mdss_dsi0>;
		qcom,mdss-dsi-panel-type = "dsi_video_mode";
		qcom,mdss-dsi-panel-destination = "display_1";
		qcom,mdss-dsi-panel-framerate = <60>;
		qcom,mdss-dsi-virtual-channel-id = <0>;
		qcom,mdss-dsi-stream = <0>;

		qcom,mdss-dsi-panel-width = <1080>;
		qcom,mdss-dsi-panel-height = <1920>;
		qcom,mdss-dsi-h-front-porch = <128>;
		qcom,mdss-dsi-h-back-porch = <76>;
		qcom,mdss-dsi-h-pulse-width = <4>;
		qcom,mdss-dsi-h-sync-skew = <0>;
		qcom,mdss-dsi-v-back-porch = <4>;
		qcom,mdss-dsi-v-front-porch = <4>;
		qcom,mdss-dsi-v-pulse-width = <6>;


		qcom,mdss-pan-physical-width-dimension = <73>;
		qcom,mdss-pan-physical-height-dimension = <125>;

		qcom,mdss-dsi-h-left-border = <0>;
		qcom,mdss-dsi-h-right-border = <0>;
		qcom,mdss-dsi-v-top-border = <0>;
		qcom,mdss-dsi-v-bottom-border = <0>;
		qcom,mdss-dsi-bpp = <24>;
		qcom,mdss-dsi-color-order = "rgb_swap_rgb";
		qcom,mdss-dsi-underflow-color = <0xff>;
		qcom,mdss-dsi-border-color = <0>;

		qcom,mdss-dsi-on-command = [
			39 01 00 00 00 00 02 FF 00
			39 01 00 00 00 00 02 D3 0A
			39 01 00 00 00 00 02 D4 04
			39 01 00 00 00 00 02 FF 01
			39 01 00 00 00 00 02 FB 01
			39 01 00 00 00 00 02 6D 77
			39 01 00 00 00 00 02 FF 05
			39 01 00 00 00 00 02 FB 01
			39 01 00 00 00 00 02 24 55
			39 01 00 00 00 00 02 35 4F
			39 01 00 00 00 00 02 7E 02
			39 01 00 00 00 00 02 7F 12
			39 01 00 00 00 00 02 81 07
			39 01 00 00 00 00 02 84 06
			39 01 00 00 00 00 02 85 07
			39 01 00 00 00 00 02 94 0A
			39 01 00 00 00 00 02 FF 00

			/* Sleep out */
			05 01 00 00 78 00 01 11
			/* Display On */
			05 01 00 00 00 00 01 29
			];
		qcom,mdss-dsi-off-command = [
			/* CMD1 Page Select */
			39 01 00 00 00 00 02 FF 00
			/* Display off */
			05 01 00 00 32 00 01 28
			/* Sleep in */
			05 01 00 00 64 00 01 10];
		/*qcom,mdss-dsi-on-command-state = "dsi_lp_mode";*/
		qcom,mdss-dsi-on-command-state = "dsi_lp_mode";
		qcom,mdss-dsi-off-command-state = "dsi_hs_mode";
		qcom,mdss-dsi-h-sync-pulse = <0>;
		qcom,mdss-dsi-lane-map = "lane_map_0123";
		qcom,mdss-dsi-bllp-eof-power-mode;
		qcom,mdss-dsi-bllp-power-mode;
		qcom,mdss-dsi-lane-0-state;
		qcom,mdss-dsi-lane-1-state;
		qcom,mdss-dsi-lane-2-state;
		qcom,mdss-dsi-lane-3-state;
		qcom,mdss-dsi-panel-timings = [E6 38 26 00 68 6C
			2A 3C 44 03 04 00];

		qcom,mdss-dsi-reset-sequence = <0 0>, <0 0>, <1 5>;
		qcom,mdss-dsi-t-clk-post = <0x2>;
		qcom,mdss-dsi-t-clk-pre = <0x2D>;
		qcom,mdss-dsi-dma-trigger = "trigger_sw";

		/* KYH 20150904 modified from none to trigger_sw */
		qcom,mdss-dsi-mdp-trigger = "trigger_sw";

		qcom,cont-splash-enabled;
		//qcom,mdss-dsi-force-clock-lane-hs;

		/* KYH 20150904 modified from DSI_NON_BURST_SYNCH_PULSE to DSI_NON_BURST_SYNCH_EVENT */
		qcom,mdss-dsi-traffic-mode = "non_burst_sync_event";

		qcom,mdss-dsi-post-init-delay = <1>;

		lge,blmap-size = <256>;
		lge,blmap = <
			0 45 45 45 45 45 45 45 45 45 				/* 0 ~ 9 */
			45 45 45 46 46 46 47 47 48 48				/* 10 ~ 19 */
			48 49 49 50 51 52 54 55 57 58				/* 20 ~ 29 */
			59 61 62 64 65 67 69 71 74 76				/* 30 ~ 39 */
			78 81 83 85 88 90 92 95 97 100				/* 40 ~ 49 */
			105 110 115 120 125 130 135 140 145 150			/* 50 ~ 59 */
			154 159 163 168 172 177 181 186 190 195			/* 60 ~ 69 */
			199 204 208 213 219 226 233 240 247 254			/* 70 ~ 79 */
			260 267 274 281 288 295 302 310 318 326			/* 80 ~ 89 */
			334 342 350 358 366 374 382 390 398 408			/* 90 ~ 99 */
			418 429 439 450 460 471 481 492 502 513			/* 100 ~ 109 */
			523 534 545 556 567 578 589 600 611 622			/* 110 ~ 119 */
			633 644 655 665 676 687 698 709 720 731			/* 120 ~ 129 */
			742 753 764 775 817 833 850 866 883 900			/* 130 ~ 139 */
			916 933 950 966 983 1000 1026 1052 1078 1104		/* 140 ~ 149 */
			1130 1156 1183 1209 1235 1261 1287 1313 1340 1347	/* 150 ~ 159 */
			1355 1363 1371 1379 1387 1395 1403 1411 1419 1427	/* 160 ~ 169 */
			1435 1454 1474 1493 1513 1533 1552 1572 1591 1611	/* 170 ~ 179 */
			1631 1650 1670 1690 1713 1737 1761 1785 1808 1832	/* 180 ~ 189 */
			1856 1880 1903 1927 1951 1975 1999 2023 2047 2071	/* 190 ~ 199 */
			2096 2120 2144 2168 2193 2217 2241 2265 2290 2320	/* 200 ~ 209 */
			2350 2380 2410 2440 2470 2500 2530 2560 2590 2620	/* 210 ~ 219 */
			2647 2675 2703 2730 2758 2786 2813 2841 2869 2896	/* 220 ~ 229 */
			2924 2952 2980 3012 3045 3077 3110 3142 3175 3207	/* 230 ~ 239 */
			3240 3272 3305 3337 3370 3409 3448 3487 3526 3565	/* 240 ~ 249 */
			3604 3643 3682 3721 3760 3800>;				/* 250 ~ 255 */
	};
};
