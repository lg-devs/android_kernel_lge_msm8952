qcom,LGE_BLT27_LGC_6000mAh {
	/* #2403089_LGE_BLT27_6000mAh_averaged_MasterSlave_Apr28th2016*/
	qcom,max-voltage-uv = <4400000>;
	qcom,nom-batt-capacity-mah = <6000>;
	qcom,batt-id-kohm = <0>;
	qcom,battery-beta = <4150>;
	qcom,battery-type = "LGE_BLT27_LGC_6000mAh";
	qcom,chg-rslow-comp-c1 = <2909690>;
	qcom,chg-rslow-comp-c2 = <3632105>;
	qcom,chg-rs-to-rslow = <635391>;
	qcom,chg-rslow-comp-thr = <0x99>;
	qcom,checksum = <0xD730>;
	qcom,gui-version = "PMI8950GUI - 2.0.0.15";
	qcom,fg-profile-data = [
		 1A 83 D6 69
		 1D 6B 86 39
		 3E 83 19 71
		 D2 74 7A 6A
		 C3 81 86 9B
		 97 BE 3E D0
		 7D 0E 09 88
		 38 7E 02 82
		 71 7C 6C 83
		 54 74 A6 89
		 B4 94 41 82
		 8B 98 01 B6
		 51 C1 58 16
		 E5 17 D6 59
		 14 70 9A F9
		 C8 46 D6 44
		 3F 49 00 00
		 EA 46 F4 3A
		 06 3D 00 00
		 00 00 00 00
		 00 00 00 00
		 C7 69 61 69
		 A0 69 25 89
		 D7 77 5D 6B
		 13 54 02 81
		 33 77 E6 69
		 4D 6B 3F B1
		 20 59 60 4A
		 5D A0 71 0C
		 28 00 FF 36
		 F0 11 30 03
		 00 00 00 0C
	];
};
